/// assign_4_6_frequency.cpp
/// Dallas Hart
/// Copyright 1/3/2020
/// prints the frequency of each word in romeo and julliet

#include <iostream>
#include <iomanip>
#include <fstream>
#include <string>

using namespace std;

int main()
{
    /// open file
    ifstream play;
    play.open("Romeo_julliet.txt");
    if (play.is_open())
    {
        string inWord;
        /// list of words in file
        string* words = new string[1];
        /// list of frequencys of words
        int* frequency = new int[1];
        int numOfWords = 0;
        float totalWords = 0;
        while (play >> inWord)
        {
            /// upercase the word
            for (int i = 0; i<inWord.size(); i++)
            {
                inWord[i] = toupper(inWord[i]);
            }

            /// delete last character if incomatable
            totalWords++;
            if (inWord.back() == ',' || inWord.back() == '!' || inWord.back() == '?' || inWord.back() == ':' || inWord.back() == '.' || inWord.back() == ';')
            {
                inWord.pop_back();
            }

            /// check if new word
            bool newWord = true;
            for (int i = 0; i<numOfWords; i++)
            {
                if (inWord == words[i])
                {
                    newWord = false;
                    frequency[i]++;
                    break;
                }
            }
            /// if a new word add all its dependancies
            if (newWord)
            {
                numOfWords++;
                /// add stuff to the arrays
                string* tempW = new string[numOfWords];
                int* tempF = new int[numOfWords];
                for (int i=0; i<numOfWords; i++)
                {
                    tempW[i] = words[i];
                    tempF[i] = frequency[i];
                }
                words = new string[numOfWords+1];
                frequency = new int[numOfWords+1];
                for (int i=0; i<numOfWords; i++)
                {
                    words[i] = tempW[i];
                    frequency[i] = tempF[i];
                }
                words[numOfWords]=inWord;
                frequency[numOfWords]=1;
                /// delete temp arrays
                delete[] tempW;
                delete[] tempF;
            }
        }
        /// display results
        cout << fixed << setprecision(2);
        for (int i=0; i<numOfWords; i++)
        {
            cout << setw(20) << words[i] << " |" << setw(6) << frequency[i] << " times" << endl;
        }
        /// close file
        play.close();
    }
    else
    {
        cout << "Unable to open file!";
    }
    return 0;
}

/*
TEST CASES

                     |     0 times
               ROMEO |   291 times
                 AND |   718 times
              JULIET |   175 times
         SHAKESPEARE |     1 times
            HOMEPAGE |     1 times
                   | |     1 times
                   | |     1 times
              ENTIRE |     1 times
                PLAY |     9 times
                 ACT |     7 times
                   I |   570 times
            PROLOGUE |     3 times
                 TWO |    22 times
          HOUSEHOLDS |     1 times
                BOTH |    23 times
               ALIKE |     3 times
                  IN |   322 times
             DIGNITY |     1 times
                FAIR |    43 times
              VERONA |    10 times
               WHERE |    51 times
                  WE |    66 times
                 LAY |    11 times
                 OUR |    60 times
               SCENE |    26 times
                FROM |    86 times
             ANCIENT |     9 times
              GRUDGE |     1 times
               BREAK |     5 times
                  TO |   520 times
                 NEW |    12 times
              MUTINY |     2 times
               CIVIL |     4 times
               BLOOD |    17 times
               MAKES |    12 times
               HANDS |    13 times
             UNCLEAN |     1 times
               FORTH |    12 times
                 THE |   681 times
               FATAL |     4 times
               LOINS |     1 times
                  OF |   392 times
               THESE |    43 times
                FOES |     1 times
                   A |   461 times
                PAIR |     2 times
        STAR-CROSS'D |     1 times
              LOVERS |     3 times
                TAKE |    41 times
               THEIR |    47 times
                LIFE |    21 times
               WHOSE |    15 times
       MISADVENTURED |     1 times
             PITEOUS |     5 times
          OVERTHROWS |     1 times
                  DO |    89 times
                WITH |   251 times
               DEATH |    68 times
                BURY |     3 times
            PARENTS' |     2 times
              STRIFE |     2 times
             FEARFUL |     7 times
             PASSAGE |     1 times
        DEATH-MARK'D |     1 times
                LOVE |   133 times
         CONTINUANCE |     1 times
                RAGE |     4 times
               WHICH |    60 times
                 BUT |   181 times
          CHILDREN'S |     1 times
                 END |     9 times
              NOUGHT |     2 times
               COULD |    17 times
              REMOVE |     4 times
                  IS |   345 times
                 NOW |    82 times
              HOURS' |     1 times
             TRAFFIC |     1 times
               STAGE |     1 times
                  IF |    82 times
                 YOU |   290 times
             PATIENT |     3 times
                EARS |    10 times
              ATTEND |     4 times
                WHAT |   164 times
                HERE |    78 times
               SHALL |   110 times
                MISS |     2 times
                TOIL |     3 times
              STRIVE |     1 times
                MEND |     2 times
              PUBLIC |     3 times
               PLACE |    11 times
               ENTER |    74 times
             SAMPSON |    21 times
             GREGORY |    18 times
               HOUSE |    27 times
             CAPULET |   133 times
               ARMED |     1 times
              SWORDS |     5 times
            BUCKLERS |     1 times
                  O' |    11 times
                  MY |   357 times
                WORD |    28 times
               WE'LL |    10 times
                 NOT |   256 times
               CARRY |     2 times
               COALS |     1 times
                  NO |   101 times
                 FOR |   222 times
                THEN |    83 times
              SHOULD |    49 times
                  BE |   208 times
            COLLIERS |     1 times
                MEAN |     9 times
                  AN |    77 times
              CHOLER |     2 times
                DRAW |    11 times
                  AY |    26 times
               WHILE |     7 times
                LIVE |    19 times
                YOUR |   102 times
                NECK |     2 times
                 OUT |    52 times
              COLLAR |     1 times
              STRIKE |     5 times
             QUICKLY |     5 times
               BEING |    25 times
               MOVED |     7 times
                THOU |   276 times
                 ART |    54 times
                 DOG |     5 times
            MONTAGUE |    40 times
               MOVES |     1 times
                  ME |   261 times
                MOVE |     9 times
                STIR |     6 times
             VALIANT |     2 times
               STAND |    26 times
           THEREFORE |    23 times
             RUNN'ST |     1 times
                AWAY |    23 times
                THAT |   344 times
                WILL |   147 times
                WALL |    10 times
                 ANY |    21 times
                 MAN |    63 times
                  OR |    67 times
                MAID |     9 times
          MONTAGUE'S |     2 times
               SHOWS |     7 times
                THEE |   136 times
                WEAK |     3 times
               SLAVE |     3 times
             WEAKEST |     1 times
                GOES |     3 times
                TRUE |    27 times
               WOMEN |     4 times
              WEAKER |     1 times
             VESSELS |     1 times
                 ARE |    68 times
                EVER |    12 times
              THRUST |     3 times
                PUSH |     1 times
                 MEN |    20 times
                 HIS |   133 times
               MAIDS |     6 times
             QUARREL |    11 times
             BETWEEN |     3 times
             MASTERS |     1 times
                  US |    30 times
                'TIS |    40 times
                 ALL |    95 times
                 ONE |    59 times
                SHOW |    11 times
              MYSELF |    14 times
              TYRANT |     2 times
                WHEN |    52 times
                HAVE |   127 times
              FOUGHT |     4 times
               CRUEL |     4 times
                 CUT |     4 times
                 OFF |    10 times
               HEADS |     4 times
               HEADS |     1 times
         MAIDENHEADS |     1 times
                  IT |   224 times
               SENSE |     3 times
                WILT |    29 times
                THEY |    57 times
                MUST |    40 times
                FEEL |     6 times
                FEEL |     1 times
                  AM |    59 times
                ABLE |     2 times
               KNOWN |     4 times
              PRETTY |     7 times
               PIECE |     2 times
               FLESH |     7 times
                WELL |    58 times
                FISH |     2 times
               HADST |     5 times
               HADST |     1 times
                BEEN |    20 times
                POOR |    18 times
                JOHN |     9 times
                 THY |   167 times
                TOOL |     1 times
               COMES |    27 times
           MONTAGUES |     5 times
               NAKED |     1 times
              WEAPON |     2 times
                BACK |    28 times
                 HOW |    57 times
                TURN |    12 times
                 RUN |    13 times
                FEAR |    15 times
               MARRY |    22 times
                 LET |    45 times
                 LAW |    11 times
               SIDES |     1 times
                THEM |    43 times
               BEGIN |     4 times
               FROWN |     2 times
                  AS |   156 times
                PASS |     3 times
                  BY |   114 times
                LIST |     1 times
                 NAY |    20 times
                DARE |     5 times
                BITE |     8 times
               THUMB |     6 times
                  AT |    69 times
            DISGRACE |     1 times
                BEAR |    12 times
             ABRAHAM |     6 times
           BALTHASAR |    18 times
                 SIR |    56 times
                 SIR |     1 times
              [ASIDE |     1 times
            GREGORY] |     1 times
                SIDE |     4 times
                 SAY |    52 times
               SERVE |     6 times
                GOOD |    82 times
              BETTER |    11 times
           'BETTER:' |     1 times
            MASTER'S |     2 times
             KINSMEN |     4 times
                 YES |     2 times
                 LIE |    22 times
            REMEMBER |     6 times
            SWASHING |     1 times
                BLOW |     2 times
               FIGHT |     6 times
            BENVOLIO |    79 times
            BENVOLIO |     1 times
                PART |    22 times
               FOOLS |     2 times
                 PUT |    18 times
                  UP |    56 times
                KNOW |    35 times
               BEATS |     4 times
                DOWN |    20 times
              TYBALT |    65 times
              TYBALT |     1 times
               DRAWN |     3 times
               AMONG |     6 times
           HEARTLESS |     1 times
               HINDS |     1 times
                LOOK |    31 times
                UPON |    43 times
                KEEP |    16 times
               PEACE |    19 times
               SWORD |     8 times
              MANAGE |     2 times
                TALK |    12 times
                HATE |    12 times
                HATE |     1 times
                HELL |     5 times
              COWARD |     1 times
             SEVERAL |     1 times
              HOUSES |     5 times
                 WHO |    35 times
                JOIN |     1 times
                FRAY |     5 times
            CITIZENS |     4 times
               CLUBS |     2 times
               FIRST |    33 times
             CITIZEN |     3 times
               BILLS |     1 times
           PARTISANS |     2 times
                BEAT |     4 times
            CAPULETS |     6 times
                GOWN |     1 times
                LADY |   103 times
               NOISE |     8 times
                THIS |   216 times
                GIVE |    47 times
                LONG |    16 times
                  HO |    13 times
              CRUTCH |     1 times
              CRUTCH |     1 times
                 WHY |    37 times
                CALL |    23 times
                 OLD |    27 times
                COME |    96 times
          FLOURISHES |     1 times
               BLADE |     2 times
               SPITE |     4 times
             VILLAIN |    17 times
      CAPULET,--HOLD |     1 times
                  GO |    76 times
               SHALT |    11 times
                FOOT |     9 times
                SEEK |     4 times
                 FOE |     5 times
              PRINCE |    33 times
          ATTENDANTS |     2 times
          REBELLIOUS |     1 times
            SUBJECTS |     1 times
             ENEMIES |     2 times
           PROFANERS |     1 times
   NEIGHBOUR-STAINED |     1 times
            STEEL,-- |     1 times
                HEAR |    22 times
              BEASTS |     1 times
              QUENCH |     2 times
                FIRE |     6 times
          PERNICIOUS |     1 times
              PURPLE |     1 times
           FOUNTAINS |     1 times
             ISSUING |     1 times
               VEINS |     4 times
                  ON |    77 times
                PAIN |     3 times
             TORTURE |     4 times
               THOSE |    16 times
              BLOODY |     7 times
               THROW |     1 times
         MISTEMPER'D |     1 times
             WEAPONS |     2 times
              GROUND |     9 times
            SENTENCE |     2 times
               THREE |     7 times
              BRAWLS |     2 times
                BRED |     1 times
                AIRY |     3 times
              THRICE |     1 times
           DISTURB'D |     1 times
               QUIET |     4 times
             STREETS |     4 times
                MADE |    20 times
            VERONA'S |     2 times
                CAST |     3 times
               GRAVE |    17 times
           BESEEMING |     1 times
           ORNAMENTS |     2 times
               WIELD |     1 times
            CANKER'D |     1 times
            CANKER'D |     1 times
             DISTURB |     2 times
               AGAIN |    26 times
               LIVES |    14 times
                 PAY |     4 times
             FORFEIT |     2 times
                TIME |    34 times
                REST |    15 times
              DEPART |     4 times
               ALONG |     4 times
           AFTERNOON |     3 times
             FURTHER |     5 times
            PLEASURE |     5 times
                CASE |     9 times
           FREE-TOWN |     1 times
              COMMON |     2 times
      JUDGMENT-PLACE |     1 times
                ONCE |    10 times
                MORE |    67 times
              EXEUNT |    30 times
                 SET |    10 times
             ABROACH |     1 times
               SPEAK |    28 times
              NEPHEW |     1 times
                WERE |    37 times
               BEGAN |     2 times
            SERVANTS |     2 times
           ADVERSARY |     1 times
               YOURS |     4 times
               CLOSE |     6 times
            FIGHTING |     1 times
                 ERE |    20 times
                 DID |    40 times
            APPROACH |     3 times
                DREW |     2 times
             INSTANT |     1 times
                CAME |    13 times
               FIERY |     2 times
            PREPARED |     1 times
                  HE |   123 times
            BREATHED |     2 times
            DEFIANCE |     1 times
               SWUNG |     1 times
               ABOUT |    11 times
                HEAD |    14 times
               WINDS |     2 times
             NOTHING |    14 times
                HURT |     6 times
              WITHAL |     5 times
              HISS'D |     1 times
                 HIM |    95 times
               SCORN |     5 times
       INTERCHANGING |     1 times
             THRUSTS |     1 times
               BLOWS |     3 times
                TILL |    22 times
              PARTED |     1 times
              EITHER |     9 times
                   O |   145 times
                 SAW |    10 times
              TO-DAY |     3 times
               RIGHT |     5 times
                GLAD |     2 times
                 WAS |    49 times
               MADAM |    23 times
                HOUR |    17 times
              BEFORE |    20 times
          WORSHIPP'D |     1 times
                 SUN |    15 times
              PEER'D |     1 times
              GOLDEN |     4 times
              WINDOW |     5 times
                EAST |     4 times
            TROUBLED |     1 times
                MIND |     8 times
               DRAVE |     1 times
                WALK |     4 times
              ABROAD |     3 times
          UNDERNEATH |     2 times
               GROVE |     1 times
            SYCAMORE |     1 times
            WESTWARD |     1 times
             ROOTETH |     1 times
              CITY'S |     1 times
                  SO |   145 times
               EARLY |    16 times
             WALKING |     1 times
                 SEE |    36 times
                 SON |    16 times
             TOWARDS |     4 times
                WARE |     2 times
               STOLE |     1 times
                INTO |     9 times
              COVERT |     1 times
                WOOD |     1 times
           MEASURING |     1 times
          AFFECTIONS |     2 times
                 OWN |    16 times
                MOST |    16 times
              BUSIED |     1 times
             THEY'RE |     1 times
               ALONE |    16 times
             PURSUED |     2 times
              HUMOUR |     3 times
            PURSUING |     1 times
              GLADLY |     2 times
             SHUNN'D |     1 times
                FLED |     2 times
                MANY |    13 times
             MORNING |     8 times
                HATH |    63 times
               THERE |    64 times
                SEEN |     6 times
               TEARS |    20 times
          AUGMENTING |     1 times
               FRESH |     2 times
                 DEW |     4 times
              ADDING |     1 times
              CLOUDS |     7 times
              CLOUDS |     1 times
                DEEP |     6 times
               SIGHS |     5 times
                SOON |    13 times
        ALL-CHEERING |     1 times
            FURTHEST |     1 times
               SHADY |     1 times
            CURTAINS |     3 times
            AURORA'S |     1 times
                 BED |    22 times
               LIGHT |    28 times
              STEALS |     1 times
                HOME |     6 times
               HEAVY |    10 times
             PRIVATE |     2 times
             CHAMBER |    10 times
                PENS |     1 times
             HIMSELF |     9 times
               SHUTS |     2 times
             WINDOWS |     2 times
               LOCKS |     2 times
                 FAR |     6 times
            DAYLIGHT |     3 times
          ARTIFICIAL |     1 times
               NIGHT |    68 times
               BLACK |    10 times
          PORTENTOUS |     1 times
               PROVE |     6 times
              UNLESS |     6 times
             COUNSEL |     8 times
                 MAY |    47 times
               CAUSE |     5 times
               NOBLE |     8 times
               UNCLE |     4 times
             NEITHER |     2 times
                 NOR |    20 times
                 CAN |    40 times
               LEARN |     3 times
          IMPORTUNED |     1 times
               MEANS |     8 times
               OTHER |    17 times
             FRIENDS |     5 times
         AFFECTIONS' |     1 times
          COUNSELLOR |     2 times
          HIMSELF--I |     1 times
              TRUE-- |     1 times
              SECRET |     3 times
            SOUNDING |     2 times
           DISCOVERY |     1 times
                 BUD |     2 times
                 BIT |     1 times
             ENVIOUS |     6 times
                WORM |     2 times
              SPREAD |     2 times
               SWEET |    33 times
              LEAVES |     2 times
                 AIR |     7 times
            DEDICATE |     1 times
              BEAUTY |    11 times
              WHENCE |     2 times
             SORROWS |     2 times
                GROW |     2 times
               WOULD |    56 times
           WILLINGLY |     1 times
                CURE |     3 times
              PLEASE |     3 times
                STEP |     2 times
               ASIDE |     3 times
                I'LL |    71 times
           GRIEVANCE |     1 times
                MUCH |    37 times
              DENIED |     1 times
                WERT |     3 times
               HAPPY |    12 times
                STAY |    28 times
              SHRIFT |     5 times
               LET'S |     6 times
         GOOD-MORROW |     1 times
              COUSIN |    16 times
                 DAY |    42 times
               YOUNG |    23 times
              STRUCK |     2 times
                NINE |     5 times
                 SAD |     5 times
               HOURS |     7 times
                SEEM |     1 times
              FATHER |    22 times
                WENT |     1 times
               HENCE |    26 times
                FAST |     3 times
             SADNESS |     4 times
           LENGTHENS |     1 times
             ROMEO'S |    16 times
              HAVING |     7 times
              HAVING |     1 times
               SHORT |     7 times
               OUT-- |     1 times
                 HER |   152 times
              FAVOUR |     2 times
                ALAS |     8 times
              GENTLE |    12 times
                VIEW |     3 times
           TYRANNOUS |     1 times
               ROUGH |     5 times
               PROOF |     3 times
             MUFFLED |     1 times
               STILL |    14 times
             WITHOUT |    13 times
                EYES |    26 times
            PATHWAYS |     1 times
                DINE |     1 times
                 YET |    47 times
                TELL |    45 times
               HEARD |     2 times
              HERE'S |     9 times
            BRAWLING |     1 times
              LOVING |     6 times
               THING |    17 times
              CREATE |     1 times
           LIGHTNESS |     1 times
             SERIOUS |     1 times
              VANITY |     2 times
          MIS-SHAPEN |     1 times
               CHAOS |     1 times
        WELL-SEEMING |     1 times
               FORMS |     1 times
             FEATHER |     1 times
                LEAD |     6 times
              BRIGHT |     5 times
               SMOKE |     2 times
                COLD |     7 times
                SICK |     7 times
              HEALTH |     1 times
        STILL-WAKING |     1 times
               SLEEP |    12 times
                DOST |    15 times
               LAUGH |     3 times
                 COZ |     4 times
              RATHER |     4 times
                WEEP |     9 times
               HEART |    26 times
             HEART'S |     4 times
          OPPRESSION |     3 times
                SUCH |    46 times
              LOVE'S |    12 times
       TRANSGRESSION |     1 times
              GRIEFS |     3 times
                MINE |    28 times
              BREAST |     6 times
           PROPAGATE |     1 times
               PREST |     1 times
               THINE |    13 times
                HAST |    28 times
               SHOWN |     2 times
                DOTH |    47 times
                 ADD |     1 times
               GRIEF |    13 times
                 TOO |    57 times
              RAISED |     2 times
                FUME |     1 times
              PURGED |     2 times
           SPARKLING |     1 times
             LOVERS' |     5 times
               VEX'D |     2 times
                 SEA |     7 times
           NOURISH'D |     1 times
                ELSE |    13 times
             MADNESS |     1 times
            DISCREET |     1 times
             CHOKING |     1 times
                GALL |     2 times
          PRESERVING |     1 times
            FAREWELL |    21 times
                SOFT |     5 times
               LEAVE |    13 times
               WRONG |     2 times
                 TUT |     4 times
                LOST |     3 times
                HE'S |    11 times
                SOME |    56 times
               GROAN |     1 times
               GROAN |     1 times
               SADLY |     1 times
                 BID |    18 times
                MAKE |    40 times
                  AH |    18 times
                 ILL |    12 times
               URGED |     3 times
               WOMAN |     3 times
               AIM'D |     1 times
                NEAR |     7 times
            SUPPOSED |     3 times
               LOVED |     3 times
            MARK-MAN |     1 times
               SHE'S |    10 times
                MARK |     5 times
             SOONEST |     1 times
                 HIT |     6 times
                 HIT |     1 times
              SHE'LL |     2 times
             CUPID'S |     2 times
               ARROW |     1 times
                 SHE |   113 times
              DIAN'S |     1 times
                 WIT |    12 times
              STRONG |     3 times
            CHASTITY |     1 times
               ARM'D |     2 times
            CHILDISH |     1 times
                 BOW |     3 times
            UNHARM'D |     1 times
               SIEGE |     2 times
               TERMS |     1 times
                BIDE |     1 times
           ENCOUNTER |     3 times
           ASSAILING |     1 times
                 OPE |     2 times
                 LAP |     1 times
      SAINT-SEDUCING |     1 times
                GOLD |     5 times
                RICH |    10 times
                ONLY |     9 times
                DIES |     5 times
                DIES |     1 times
               STORE |     2 times
               SWORN |     3 times
              CHASTE |     1 times
             SPARING |     1 times
                HUGE |     1 times
               WASTE |     3 times
             STARVED |     1 times
            SEVERITY |     1 times
                CUTS |     1 times
           POSTERITY |     1 times
                WISE |     5 times
              WISELY |     5 times
               MERIT |     2 times
               BLISS |     2 times
              MAKING |     3 times
             DESPAIR |     2 times
            FORSWORN |     4 times
                 VOW |     3 times
                DEAD |    45 times
               RULED |     3 times
              FORGET |     9 times
               THINK |    20 times
               TEACH |     3 times
              GIVING |     3 times
             LIBERTY |     3 times
                UNTO |     9 times
             EXAMINE |     2 times
            BEAUTIES |     3 times
                 WAY |     9 times
                HERS |     4 times
           EXQUISITE |     1 times
            QUESTION |     2 times
               MASKS |     1 times
                KISS |    10 times
             LADIES' |     1 times
               BROWS |     3 times
                HIDE |     8 times
            STRUCKEN |     1 times
               BLIND |     5 times
              CANNOT |    21 times
            PRECIOUS |     3 times
            TREASURE |     1 times
            EYESIGHT |     2 times
            MISTRESS |     8 times
             PASSING |     2 times
                NOTE |     4 times
                READ |     6 times
              PASS'D |     1 times
               CANST |     7 times
            DOCTRINE |     1 times
                 DIE |    23 times
                DEBT |     2 times
                  II |     6 times
              STREET |     6 times
               PARIS |    56 times
             SERVANT |    27 times
               BOUND |     8 times
             PENALTY |     1 times
                HARD |     3 times
          HONOURABLE |     5 times
           RECKONING |     2 times
                PITY |     2 times
               LIVED |     1 times
                ODDS |     1 times
                LORD |    30 times
                SUIT |     3 times
              SAYING |     1 times
                O'ER |    11 times
                SAID |    15 times
               CHILD |    15 times
            STRANGER |     1 times
               WORLD |    15 times
              CHANGE |     5 times
            FOURTEEN |     6 times
               YEARS |    12 times
             SUMMERS |     1 times
              WITHER |     1 times
               PRIDE |     2 times
                RIPE |     1 times
               BRIDE |     5 times
             YOUNGER |     2 times
                THAN |    47 times
             MOTHERS |     2 times
              MARR'D |     1 times
               EARTH |    19 times
           SWALLOW'D |     1 times
               HOPES |     1 times
             HOPEFUL |     1 times
                 WOO |     4 times
                 GET |    13 times
             CONSENT |     5 times
               AGREE |     1 times
              WITHIN |    16 times
               SCOPE |     1 times
              CHOICE |     2 times
                LIES |    19 times
           ACCORDING |     1 times
               VOICE |     5 times
                HOLD |    15 times
          ACCUSTOM'D |     1 times
               FEAST |     6 times
             WHERETO |     1 times
             INVITED |     1 times
               GUEST |     2 times
             WELCOME |     8 times
              NUMBER |     2 times
              BEHOLD |     7 times
      EARTH-TREADING |     1 times
               STARS |     7 times
                DARK |     7 times
              HEAVEN |    28 times
             COMFORT |    10 times
               LUSTY |     2 times
     WELL-APPARELL'D |     1 times
               APRIL |     1 times
                HEEL |     2 times
             LIMPING |     1 times
              WINTER |     1 times
              TREADS |     1 times
                EVEN |    12 times
             DELIGHT |     3 times
              FEMALE |     1 times
                BUDS |     1 times
             INHERIT |     1 times
                LIKE |    40 times
              THOUGH |    11 times
                NONE |    15 times
               PAPER |     2 times
              SIRRAH |     6 times
              TRUDGE |     2 times
             THROUGH |     8 times
                FIND |    24 times
             PERSONS |     2 times
               NAMES |     4 times
             WRITTEN |     4 times
             WRITTEN |     1 times
           SHOEMAKER |     1 times
              MEDDLE |     1 times
                YARD |     1 times
              TAILOR |     2 times
                LAST |     8 times
              FISHER |     1 times
              PENCIL |     1 times
             PAINTER |     1 times
                NETS |     1 times
                SENT |     2 times
                WRIT |     7 times
               NEVER |    18 times
             WRITING |     1 times
              PERSON |     2 times
        LEARNED.--IN |     1 times
               BURNS |     1 times
           ANOTHER'S |     3 times
             BURNING |     2 times
            LESSEN'D |     1 times
             ANGUISH |     1 times
               GIDDY |     1 times
                HOLP |     1 times
            BACKWARD |     3 times
             TURNING |     2 times
           DESPERATE |    10 times
               CURES |     1 times
            LANGUISH |     1 times
           INFECTION |     2 times
                 EYE |    18 times
                RANK |     1 times
              POISON |    14 times
      PLAINTAIN-LEAF |     1 times
           EXCELLENT |     2 times
                PRAY |    17 times
              BROKEN |     1 times
                SHIN |     1 times
                 MAD |     8 times
                 MAD |     1 times
             MAD-MAN |     1 times
                SHUT |     5 times
              PRISON |     2 times
                KEPT |     1 times
                FOOD |     3 times
             WHIPP'D |     1 times
           TORMENTED |     1 times
        AND--GOD-DEN |     1 times
              FELLOW |     5 times
                 GOD |    26 times
                 GI' |     1 times
             GOD-DEN |     2 times
             FORTUNE |     7 times
              MISERY |     2 times
             PERHAPS |     1 times
             LEARNED |     1 times
                BOOK |     7 times
             LETTERS |     5 times
            LANGUAGE |     1 times
                  YE |    11 times
            HONESTLY |     1 times
               MERRY |     8 times
               READS |     1 times
            'SIGNIOR |     1 times
             MARTINO |     1 times
                WIFE |    19 times
           DAUGHTERS |     2 times
              COUNTY |    16 times
             ANSELME |     1 times
           BEAUTEOUS |     2 times
             SISTERS |     1 times
               WIDOW |     1 times
            VITRAVIO |     1 times
             SIGNIOR |     3 times
           PLACENTIO |     1 times
              LOVELY |     2 times
              NIECES |     1 times
            MERCUTIO |    83 times
             BROTHER |     5 times
           VALENTINE |     1 times
               NIECE |     1 times
            ROSALINE |     9 times
               LIVIA |     1 times
            VALENTIO |     1 times
               LUCIO |     1 times
              LIVELY |     1 times
            HELENA.' |     1 times
            ASSEMBLY |     1 times
             WHITHER |     1 times
             WHITHER |     1 times
              SUPPER |     4 times
              INDEED |     9 times
               ASK'D |     1 times
              ASKING |     1 times
              MASTER |    10 times
               GREAT |     9 times
               CRUSH |     1 times
                 CUP |     3 times
                WINE |     1 times
                EXIT |    31 times
                SAME |    14 times
           CAPULET'S |    11 times
                SUPS |     1 times
                WHOM |     6 times
              LOVEST |     2 times
             ADMIRED |     1 times
             THITHER |     4 times
         UNATTAINTED |     1 times
             COMPARE |     3 times
                FACE |    22 times
                SWAN |     1 times
                CROW |     3 times
              DEVOUT |     1 times
            RELIGION |     1 times
           MAINTAINS |     1 times
           FALSEHOOD |     1 times
               FIRES |     1 times
               OFTEN |     2 times
             DROWN'D |     1 times
         TRANSPARENT |     1 times
            HERETICS |     1 times
               BURNT |     2 times
               LIARS |     1 times
              FAIRER |     2 times
          ALL-SEEING |     1 times
               NE'ER |    10 times
               MATCH |     4 times
               SINCE |    11 times
               BEGUN |     1 times
             HERSELF |     6 times
              POISED |     1 times
             CRYSTAL |     1 times
              SCALES |     1 times
             WEIGH'D |     1 times
              LADY'S |     8 times
             AGAINST |    10 times
             SHINING |     1 times
               SCANT |     1 times
                BEST |    12 times
               SIGHT |     9 times
             REJOICE |     2 times
            SPLENDOR |     1 times
                 III |     6 times
                ROOM |     4 times
               NURSE |   142 times
               NURSE |     1 times
             WHERE'S |     6 times
            DAUGHTER |    13 times
          MAIDENHEAD |     2 times
              TWELVE |     2 times
                YEAR |     3 times
                BADE |     5 times
                LAMB |     4 times
            LADYBIRD |     1 times
              FORBID |     2 times
                GIRL |     6 times
               CALLS |    10 times
              MOTHER |    14 times
      MATTER:--NURSE |     1 times
              AWHILE |     6 times
      SECRET:--NURSE |     1 times
          REMEMBER'D |     1 times
              THOU'S |     1 times
             KNOW'ST |     5 times
          DAUGHTER'S |     3 times
                 AGE |     6 times
               FAITH |    18 times
            TEETH,-- |     1 times
               TEETH |     1 times
              SPOKEN |     1 times
              FOUR-- |     1 times
         LAMMAS-TIDE |     1 times
           FORTNIGHT |     1 times
                 ODD |     2 times
                DAYS |     8 times
                DAYS |     1 times
          LAMMAS-EVE |     2 times
               SUSAN |     3 times
            SHE--GOD |     1 times
           CHRISTIAN |     1 times
            SOULS!-- |     1 times
          EARTHQUAKE |     1 times
              ELEVEN |     2 times
          WEAN'D,--I |     1 times
               IT,-- |     1 times
                 HAD |    20 times
                LAID |     5 times
            WORMWOOD |     2 times
                 DUG |     3 times
             SITTING |     2 times
               UNDER |     7 times
          DOVE-HOUSE |     2 times
           MANTUA:-- |     1 times
         BRAIN:--BUT |     1 times
               TASTE |     3 times
              NIPPLE |     1 times
                FELT |     2 times
              BITTER |     4 times
                FOOL |     6 times
              TETCHY |     1 times
                FALL |    14 times
               SHAKE |     2 times
               QUOTH |     5 times
               'TWAS |     3 times
                NEED |    10 times
                TROW |     2 times
                ROOD |     1 times
             WADDLED |     1 times
               BROKE |     2 times
                BROW |     4 times
        HUSBAND--GOD |     1 times
                SOUL |    13 times
                  A' |     5 times
           MAN--TOOK |     1 times
              'YEA,' |     2 times
               'DOST |     1 times
              JULE?' |     3 times
            HOLIDAME |     1 times
              WRETCH |     3 times
                LEFT |     4 times
              CRYING |     2 times
               'AY.' |     4 times
                JEST |     6 times
             WARRANT |    11 times
            THOUSAND |     7 times
               'WILT |     1 times
             STINTED |     2 times
              ENOUGH |     7 times
              CHOOSE |     3 times
                 ITS |     1 times
                BUMP |     1 times
                 BIG |     2 times
          COCKEREL'S |     1 times
               STONE |     1 times
             PARLOUS |     1 times
               KNOCK |     3 times
               CRIED |     1 times
            BITTERLY |     2 times
    HUSBAND,'FALL'ST |     1 times
              COMEST |     1 times
               STINT |     1 times
                DONE |    10 times
               GRACE |     5 times
                WAST |     6 times
           PRETTIEST |     2 times
                BABE |     1 times
                E'ER |     3 times
              NURSED |     2 times
               MIGHT |     5 times
             MARRIED |    19 times
                WISH |     6 times
             'MARRY' |     1 times
                VERY |    25 times
               THEME |     1 times
              STANDS |     4 times
         DISPOSITION |     2 times
              HONOUR |     5 times
               DREAM |    10 times
              SUCK'D |     2 times
              WISDOM |     4 times
                TEAT |     1 times
            MARRIAGE |    10 times
              LADIES |     4 times
              ESTEEM |     1 times
             ALREADY |     5 times
               COUNT |     4 times
                THUS |     9 times
               BRIEF |     5 times
               SEEKS |     1 times
          WORLD--WHY |     1 times
                 WAX |     2 times
              SUMMER |     2 times
              FLOWER |     9 times
              FLOWER |     1 times
           GENTLEMAN |    14 times
              VOLUME |     2 times
              PARIS' |     3 times
            BEAUTY'S |     2 times
                 PEN |     1 times
               EVERY |    12 times
           LINEAMENT |     1 times
             ANOTHER |    10 times
               LENDS |     3 times
             CONTENT |     3 times
            OBSCURED |     1 times
             MARGENT |     1 times
             UNBOUND |     1 times
               LOVER |     4 times
            BEAUTIFY |     1 times
               LACKS |     1 times
               COVER |     2 times
              MANY'S |     1 times
               SHARE |     2 times
               GLORY |     1 times
              CLASPS |     1 times
               STORY |     2 times
             POSSESS |     1 times
            YOURSELF |     5 times
                LESS |     5 times
                LESS |     1 times
              BIGGER |     2 times
             BRIEFLY |     1 times
             LOOKING |     1 times
              LIKING |     1 times
              ENDART |     1 times
               GIVES |     5 times
            STRENGTH |     6 times
                 FLY |     4 times
              GUESTS |     4 times
              SERVED |     2 times
              CALLED |     2 times
               ASKED |     2 times
              CURSED |     3 times
              PANTRY |     1 times
           EXTREMITY |     1 times
                WAIT |     1 times
             BESEECH |     7 times
              FOLLOW |     7 times
            STRAIGHT |    10 times
               STAYS |     2 times
              NIGHTS |     1 times
                  IV |     5 times
                FIVE |     5 times
                 SIX |     1 times
             MASKERS |     2 times
       TORCH-BEARERS |     1 times
              OTHERS |     9 times
              SPEECH |     1 times
               SPOKE |     6 times
              EXCUSE |     5 times
             APOLOGY |     1 times
                DATE |     3 times
           PROLIXITY |     1 times
               CUPID |     3 times
          HOODWINK'D |     1 times
               SCARF |     1 times
             BEARING |     2 times
            TARTAR'S |     1 times
             PAINTED |     1 times
                LATH |     1 times
             SCARING |     1 times
         CROW-KEEPER |     1 times
        WITHOUT-BOOK |     1 times
             FAINTLY |     1 times
               AFTER |     5 times
            PROMPTER |     1 times
            ENTRANCE |     2 times
             MEASURE |     6 times
             MEASURE |     1 times
                GONE |    33 times
               TORCH |     8 times
             AMBLING |     1 times
               DANCE |     5 times
             BELIEVE |     4 times
             DANCING |     2 times
               SHOES |     2 times
              NIMBLE |     1 times
               SOLES |     1 times
              STAKES |     1 times
              BORROW |     1 times
               WINGS |     5 times
                SOAR |     2 times
               ABOVE |    14 times
                SORE |     1 times
           ENPIERCED |     1 times
               SHAFT |     1 times
            FEATHERS |     1 times
               PITCH |     1 times
                DULL |     2 times
                 WOE |    13 times
              BURDEN |     3 times
                SINK |     1 times
                SINK |     1 times
              TENDER |     6 times
              TENDER |     1 times
                RUDE |     5 times
          BOISTEROUS |     1 times
              PRICKS |     1 times
               THORN |     1 times
               PRICK |     2 times
            PRICKING |     1 times
              VISAGE |     1 times
               VISOR |     2 times
               VISOR |     1 times
                CARE |     6 times
             CURIOUS |     1 times
               QUOTE |     1 times
         DEFORMITIES |     1 times
              BEETLE |     1 times
               BLUSH |     3 times
              SOONER |     1 times
              BETAKE |     1 times
                LEGS |     2 times
             WANTONS |     1 times
              TICKLE |     1 times
           SENSELESS |     1 times
              RUSHES |     2 times
               HEELS |     1 times
           PROVERB'D |     1 times
           GRANDSIRE |     2 times
              PHRASE |     1 times
       CANDLE-HOLDER |     1 times
                GAME |     1 times
               DUN'S |     1 times
               MOUSE |     3 times
         CONSTABLE'S |     1 times
                 DUN |     1 times
                MIRE |     1 times
       SIR-REVERENCE |     1 times
             WHEREIN |     1 times
            STICK'ST |     1 times
                BURN |     3 times
              THAT'S |     8 times
               DELAY |     3 times
              LIGHTS |     2 times
                VAIN |     3 times
               LAMPS |     1 times
             MEANING |     3 times
            JUDGMENT |     2 times
                SITS |     2 times
               TIMES |     8 times
                WITS |     5 times
               GOING |     4 times
                MASK |     3 times
                 ASK |     5 times
             DREAM'D |     1 times
            TO-NIGHT |    15 times
            DREAMERS |     1 times
              ASLEEP |     5 times
              THINGS |     8 times
               QUEEN |     1 times
                 MAB |     3 times
            FAIRIES' |     2 times
             MIDWIFE |     1 times
               SHAPE |     5 times
         AGATE-STONE |     1 times
         FORE-FINGER |     1 times
            ALDERMAN |     1 times
                TEAM |     1 times
              LITTLE |    12 times
             ATOMIES |     1 times
             ATHWART |     1 times
               MEN'S |     8 times
               NOSES |     1 times
        WAGON-SPOKES |     1 times
            SPIDERS' |     1 times
        GRASSHOPPERS |     1 times
              TRACES |     1 times
            SMALLEST |     1 times
            SPIDER'S |     1 times
                 WEB |     1 times
             COLLARS |     1 times
         MOONSHINE'S |     1 times
              WATERY |     1 times
               BEAMS |     2 times
                WHIP |     2 times
           CRICKET'S |     1 times
                BONE |     2 times
                LASH |     1 times
                FILM |     1 times
             WAGONER |     2 times
               SMALL |     3 times
         GREY-COATED |     1 times
                GNAT |     1 times
               ROUND |     1 times
             PRICK'D |     1 times
                LAZY |     1 times
              FINGER |     2 times
             CHARIOT |     1 times
               EMPTY |     4 times
           HAZEL-NUT |     1 times
              JOINER |     1 times
            SQUIRREL |     1 times
                GRUB |     1 times
         COACHMAKERS |     1 times
               STATE |     5 times
             GALLOPS |     2 times
              BRAINS |     2 times
          COURTIERS' |     1 times
               KNEES |     3 times
          COURT'SIES |     1 times
            LAWYERS' |     1 times
             FINGERS |     5 times
                FEES |     1 times
                   ' |     1 times
                LIPS |    17 times
              KISSES |     4 times
                 OFT |     4 times
               ANGRY |     1 times
            BLISTERS |     1 times
             PLAGUES |     1 times
             BECAUSE |    10 times
             BREATHS |     1 times
          SWEETMEATS |     1 times
             TAINTED |     1 times
            SOMETIME |     3 times
          COURTIER'S |     1 times
                NOSE |     2 times
              DREAMS |     5 times
            SMELLING |     1 times
         TITHE-PIG'S |     1 times
                TAIL |     1 times
            TICKLING |     1 times
            PARSON'S |     1 times
            BENEFICE |     1 times
             DRIVETH |     1 times
           SOLDIER'S |     2 times
             CUTTING |     1 times
             FOREIGN |     1 times
             THROATS |     1 times
            BREACHES |     1 times
         AMBUSCADOES |     1 times
             SPANISH |     1 times
              BLADES |     1 times
             HEALTHS |     1 times
         FIVE-FATHOM |     1 times
                ANON |     7 times
               DRUMS |     1 times
                 EAR |     7 times
              STARTS |     2 times
               WAKES |     3 times
            FRIGHTED |     1 times
              SWEARS |     1 times
              PRAYER |     2 times
              SLEEPS |     2 times
               PLATS |     1 times
               MANES |     1 times
              HORSES |     2 times
               BAKES |     1 times
            ELFLOCKS |     1 times
                FOUL |     4 times
            SLUTTISH |     1 times
               HAIRS |     1 times
           UNTANGLED |     1 times
          MISFORTUNE |     1 times
               BODES |     1 times
                 HAG |     1 times
               BACKS |     1 times
             PRESSES |     2 times
              LEARNS |     1 times
            CARRIAGE |     1 times
               SHE-- |     1 times
             TALK'ST |     1 times
            CHILDREN |     2 times
                IDLE |     1 times
               BRAIN |     2 times
               BEGOT |     1 times
             FANTASY |     1 times
                THIN |     1 times
           SUBSTANCE |     3 times
          INCONSTANT |     3 times
                WIND |     3 times
               WOOES |     1 times
              FROZEN |     1 times
               BOSOM |     7 times
               NORTH |     1 times
             ANGER'D |     1 times
               PUFFS |     1 times
              THENCE |     2 times
        DEW-DROPPING |     1 times
               SOUTH |     1 times
           OURSELVES |     1 times
                LATE |    11 times
            MISGIVES |     1 times
         CONSEQUENCE |     1 times
             HANGING |     1 times
             NIGHT'S |     5 times
              REVELS |     1 times
              EXPIRE |     1 times
                TERM |     2 times
            DESPISED |     3 times
              CLOSED |     3 times
                VILE |     8 times
            UNTIMELY |     5 times
            STEERAGE |     1 times
              COURSE |     4 times
              DIRECT |     1 times
                SAIL |     3 times
           GENTLEMEN |    10 times
                DRUM |     1 times
                   V |     5 times
                HALL |     5 times
           MUSICIANS |     8 times
             WAITING |     1 times
          SERVINGMEN |     3 times
             NAPKINS |     1 times
              POTPAN |     2 times
               HELPS |     2 times
               SHIFT |     1 times
            TRENCHER |     2 times
              SCRAPE |     1 times
              SECOND |    18 times
             MANNERS |     2 times
            UNWASHED |     1 times
        JOINT-STOOLS |     1 times
      COURT-CUPBOARD |     1 times
               PLATE |     1 times
                SAVE |     3 times
           MARCHPANE |     1 times
              PORTER |     1 times
          GRINDSTONE |     1 times
                NELL |     1 times
              ANTONY |     1 times
                 BOY |    10 times
               READY |     5 times
              LOOKED |     1 times
              SOUGHT |     3 times
             CHEERLY |     2 times
                BOYS |     1 times
               BRISK |     1 times
              LONGER |     5 times
               LIVER |     1 times
             MEETING |     2 times
                TOES |     1 times
           UNPLAGUED |     1 times
               CORNS |     2 times
                BOUT |     1 times
                  HA |     6 times
          MISTRESSES |     1 times
                DENY |     4 times
              DAINTY |     1 times
               SWEAR |     9 times
                WORN |     4 times
          WHISPERING |     1 times
                TALE |     6 times
               GIRLS |     1 times
               MUSIC |     7 times
               PLAYS |     2 times
              KNAVES |     1 times
              TABLES |     1 times
               GROWN |     3 times
                 HOT |     7 times
        UNLOOK'D-FOR |     1 times
               SPORT |     2 times
                 SIT |     5 times
                 SIT |     1 times
                PAST |     7 times
                IS'T |     5 times
                BY'R |     1 times
              THIRTY |     2 times
            NUPTIALS |     1 times
            LUCENTIO |     1 times
           PENTECOST |     1 times
              TWENTY |    10 times
              MASK'D |     1 times
               ELDER |     1 times
                WARD |     1 times
                 AGO |     2 times
                 [TO |     2 times
         SERVINGMAN] |     1 times
              ENRICH |     1 times
                HAND |    25 times
              YONDER |     6 times
              KNIGHT |     2 times
             TORCHES |     2 times
               SEEMS |     2 times
               HANGS |     2 times
               CHEEK |     6 times
               JEWEL |     1 times
           ETHIOPE'S |     1 times
                 USE |    14 times
                DEAR |    26 times
               SNOWY |     1 times
                DOVE |     1 times
            TROOPING |     1 times
               CROWS |     1 times
             FELLOWS |     2 times
               WATCH |    13 times
            TOUCHING |     1 times
             BLESSED |     5 times
            FORSWEAR |     1 times
               FETCH |     7 times
              RAPIER |     2 times
               DARES |     4 times
              HITHER |    12 times
             COVER'D |     1 times
               ANTIC |     2 times
               FLEER |     1 times
           SOLEMNITY |     3 times
               STOCK |     1 times
                 KIN |     1 times
                 SIN |    12 times
             KINSMAN |    11 times
           WHEREFORE |     5 times
               STORM |     2 times
               BEARS |     2 times
              PORTLY |     1 times
               TRUTH |     5 times
               BRAGS |     2 times
            VIRTUOUS |     2 times
       WELL-GOVERN'D |     1 times
               YOUTH |     6 times
              WEALTH |     2 times
                TOWN |     4 times
       DISPARAGEMENT |     1 times
             RESPECT |     2 times
            PRESENCE |     2 times
              FROWNS |     1 times
       ILL-BESEEMING |     2 times
           SEMBLANCE |     1 times
                FITS |     1 times
              ENDURE |     2 times
             ENDURED |     1 times
             GOODMAN |     1 times
              YOU'LL |     3 times
              YOU'LL |     1 times
         COCK-A-HOOP |     1 times
               SHAME |    12 times
               SAUCY |     2 times
               TRICK |     1 times
              CHANCE |     3 times
              SCATHE |     1 times
            CONTRARY |     3 times
              HEARTS |     3 times
             PRINCOX |     1 times
            OR--MORE |     1 times
            PATIENCE |     5 times
            PERFORCE |     2 times
              WILFUL |     1 times
             TREMBLE |     2 times
           DIFFERENT |     2 times
            GREETING |     2 times
            WITHDRAW |     3 times
           INTRUSION |     1 times
             SEEMING |     3 times
             CONVERT |     1 times
             JULIET] |     1 times
             PROFANE |     1 times
         UNWORTHIEST |     1 times
                HOLY |    21 times
              SHRINE |     1 times
                FINE |     5 times
            BLUSHING |     1 times
            PILGRIMS |     1 times
              SMOOTH |     2 times
               TOUCH |     3 times
             PILGRIM |     2 times
            MANNERLY |     1 times
            DEVOTION |     2 times
              SAINTS |     3 times
           PILGRIMS' |     1 times
                PALM |     1 times
                PALM |     1 times
            PALMERS' |     1 times
             PALMERS |     1 times
               SAINT |     9 times
               GRANT |     2 times
                LEST |     4 times
            PRAYERS' |     1 times
                SAKE |     4 times
            PRAYER'S |     1 times
              EFFECT |     2 times
                TOOK |     5 times
            TRESPASS |     1 times
             SWEETLY |     1 times
              CRAVES |     3 times
            BACHELOR |     1 times
              TALK'D |     2 times
              CHINKS |     1 times
             ACCOUNT |     2 times
               FOE'S |     1 times
              BEGONE |     1 times
              UNREST |     1 times
             PREPARE |     5 times
            TRIFLING |     1 times
             FOOLISH |     2 times
             BANQUET |     1 times
                E'EN |     1 times
               THANK |     5 times
               THANK |     1 times
              HONEST |     7 times
                 FAY |     1 times
               WAXES |     1 times
                YOND |     3 times
                HEIR |     5 times
             TIBERIO |     1 times
              WHAT'S |     9 times
                DOOR |     2 times
            PETRUCIO |     1 times
             FOLLOWS |     1 times
                NAME |    24 times
             WEDDING |     2 times
               ENEMY |     6 times
              SPRUNG |     1 times
             UNKNOWN |     1 times
          PRODIGIOUS |     1 times
               BIRTH |     4 times
             LOATHED |     2 times
               RHYME |     2 times
             LEARN'D |     2 times
              DANCED |     1 times
           'JULIET.' |     1 times
           STRANGERS |     1 times
              CHORUS |     1 times
              CHORUS |     1 times
              DESIRE |     2 times
           DEATH-BED |     1 times
           AFFECTION |     2 times
               GAPES |     1 times
             GROAN'D |     1 times
             MATCH'D |     2 times
             BELOVED |     1 times
               LOVES |     2 times
          BETWITCHED |     1 times
               CHARM |     1 times
               LOOKS |     7 times
            COMPLAIN |     1 times
               STEAL |     2 times
                BAIT |     1 times
               HOOKS |     1 times
                HELD |     2 times
              ACCESS |     1 times
             BREATHE |     1 times
                VOWS |     1 times
                MEET |     8 times
         NEW-BELOVED |     1 times
             PASSION |     3 times
               POWER |     5 times
           TEMPERING |     1 times
         EXTREMITIES |     1 times
             EXTREME |     1 times
                LANE |     1 times
             ORCHARD |     7 times
             FORWARD |     2 times
              CENTRE |     1 times
              CLIMBS |     1 times
               LEAPS |     1 times
              STOL'N |     2 times
                 RAN |     4 times
              LEAP'D |     1 times
             CONJURE |     4 times
             HUMOURS |     1 times
              MADMAN |     1 times
              APPEAR |     3 times
            LIKENESS |     3 times
                SIGH |     1 times
           SATISFIED |     5 times
                 CRY |     4 times
                 'AY |     1 times
                ME!' |     1 times
           PRONOUNCE |     3 times
              'LOVE' |     1 times
             'DOVE;' |     1 times
              GOSSIP |     1 times
               VENUS |     2 times
           NICK-NAME |     1 times
            PURBLIND |     1 times
                ADAM |     1 times
                SHOT |     3 times
                TRIM |     2 times
                KING |     2 times
            COPHETUA |     1 times
         BEGGAR-MAID |     1 times
             HEARETH |     1 times
            STIRRETH |     1 times
              MOVETH |     1 times
                 APE |     1 times
          ROSALINE'S |     1 times
                HIGH |     8 times
            FOREHEAD |     1 times
             SCARLET |     2 times
                 LIP |     1 times
                 LEG |     2 times
           QUIVERING |     1 times
               THIGH |     1 times
            DEMESNES |     2 times
            ADJACENT |     1 times
               ANGER |     3 times
               ANGER |     1 times
             'TWOULD |     1 times
               RAISE |     4 times
              SPIRIT |     4 times
           MISTRESS' |     2 times
              CIRCLE |     1 times
             STRANGE |     6 times
              NATURE |     4 times
             LETTING |     1 times
            CONJURED |     1 times
          INVOCATION |     1 times
             MISTRES |     1 times
                  S' |     1 times
                 HID |     3 times
               TREES |     1 times
           CONSORTED |     1 times
            HUMOROUS |     1 times
              BEFITS |     1 times
              MEDLAR |     1 times
                TREE |     1 times
                KIND |     6 times
               FRUIT |     1 times
             MEDLARS |     1 times
                OPEN |     5 times
                  ET |     1 times
             CAETERA |     1 times
             POPERIN |     1 times
                PEAR |     1 times
         TRUCKLE-BED |     1 times
           FIELD-BED |     1 times
               FOUND |     6 times
               JESTS |     1 times
               SCARS |     1 times
               WOUND |     3 times
             APPEARS |     1 times
              BREAKS |     1 times
               ARISE |     3 times
                KILL |    10 times
                MOON |     4 times
                PALE |    11 times
              VESTAL |     2 times
              LIVERY |     2 times
               GREEN |     4 times
                WEAR |     4 times
                KNEW |     3 times
              SPEAKS |     6 times
                SAYS |    10 times
          DISCOURSES |     2 times
              ANSWER |    10 times
                BOLD |     4 times
             FAIREST |     1 times
            BUSINESS |     3 times
             ENTREAT |     2 times
             TWINKLE |     1 times
             SPHERES |     1 times
              RETURN |     5 times
          BRIGHTNESS |     1 times
                LAMP |     1 times
              REGION |     1 times
              STREAM |     1 times
               BIRDS |     1 times
                SING |     2 times
               LEANS |     1 times
               GLOVE |     1 times
               ANGEL |     1 times
            GLORIOUS |     1 times
              WINGED |     1 times
           MESSENGER |     2 times
      WHITE-UPTURNED |     1 times
           WONDERING |     1 times
             MORTALS |     2 times
                GAZE |     3 times
           BESTRIDES |     1 times
         LAZY-PACING |     1 times
               SAILS |     1 times
              REFUSE |     1 times
             [ASIDE] |     5 times
             THYSELF |     7 times
                 ARM |     7 times
           BELONGING |     2 times
                ROSE |     1 times
               SMELL |     1 times
              CALL'D |     1 times
              RETAIN |     1 times
          PERFECTION |     1 times
                OWES |     1 times
               TITLE |     1 times
                DOFF |     1 times
            BAPTIZED |     1 times
          HENCEFORTH |     2 times
          BESCREEN'D |     1 times
           STUMBLEST |     1 times
             HATEFUL |     4 times
                TEAR |     5 times
               DRUNK |     3 times
             HUNDRED |     3 times
               WORDS |     7 times
            TONGUE'S |     1 times
           UTTERANCE |     1 times
               SOUND |     8 times
             DISLIKE |     1 times
              CAMEST |     2 times
               WALLS |     3 times
               CLIMB |     2 times
         CONSIDERING |     1 times
          O'ER-PERCH |     1 times
               STONY |     2 times
              LIMITS |     1 times
             ATTEMPT |     1 times
              MURDER |     6 times
               ALACK |    11 times
               PERIL |     1 times
              ENMITY |     2 times
               CLOAK |     1 times
               ENDED |     2 times
           PROROGUED |     1 times
             WANTING |     2 times
           DIRECTION |     1 times
            FOUND'ST |     1 times
              PROMPT |     1 times
             INQUIRE |     2 times
                LENT |     3 times
                LENT |     1 times
               PILOT |     2 times
                VAST |     1 times
               SHORE |     1 times
              WASH'D |     3 times
            FARTHEST |     1 times
           ADVENTURE |     2 times
         MERCHANDISE |     1 times
              MAIDEN |     1 times
             BEPAINT |     1 times
                FAIN |     5 times
               DWELL |     3 times
                FORM |     5 times
          COMPLIMENT |     1 times
               'AY,' |     1 times
            SWEAR'ST |     1 times
               MAYST |     3 times
               FALSE |     2 times
           PERJURIES |     1 times
                JOVE |     1 times
              LAUGHS |     1 times
          FAITHFULLY |     1 times
            THINK'ST |     2 times
                 WON |     1 times
            PERVERSE |     1 times
                FOND |     3 times
             'HAVIOR |     1 times
               TRUST |     5 times
             CUNNING |     2 times
             CONFESS |     3 times
        OVERHEARD'ST |     1 times
              PARDON |    10 times
              IMPUTE |     1 times
            YIELDING |     1 times
          DISCOVERED |     1 times
                TIPS |     1 times
              SILVER |     7 times
          FRUIT-TREE |     1 times
              TOPS-- |     1 times
             MONTHLY |     1 times
             CHANGES |     1 times
             CIRCLED |     1 times
                 ORB |     1 times
            LIKEWISE |     2 times
            VARIABLE |     1 times
            GRACIOUS |     1 times
                SELF |     2 times
            IDOLATRY |     1 times
              LOVE-- |     1 times
            ALTHOUGH |     1 times
                 JOY |    13 times
                 JOY |     1 times
            CONTRACT |     1 times
                RASH |     1 times
           UNADVISED |     1 times
              SUDDEN |     7 times
           LIGHTNING |     4 times
               CEASE |     3 times
                 'IT |     1 times
          LIGHTENS.' |     1 times
            SUMMER'S |     1 times
            RIPENING |     1 times
              BREATH |    14 times
                NEXT |     6 times
              REPOSE |     1 times
         UNSATISFIED |     1 times
        SATISFACTION |     1 times
            EXCHANGE |     3 times
            FAITHFUL |     3 times
                GAVE |     4 times
               DIDST |     6 times
             REQUEST |     1 times
             WOULDST |     4 times
             PURPOSE |     3 times
               FRANK |     1 times
              BOUNTY |     1 times
           BOUNDLESS |     1 times
            INFINITE |     1 times
               ADIEU |     4 times
              AFEARD |     1 times
    FLATTERING-SWEET |     1 times
         SUBSTANTIAL |     1 times
            RE-ENTER |     7 times
                BENT |     1 times
                SEND |    13 times
           TO-MORROW |    15 times
             PROCURE |     1 times
             PERFORM |     1 times
                RITE |     2 times
            FORTUNES |     1 times
          THROUGHOUT |     1 times
            [WITHIN] |     5 times
          ANON.--BUT |     1 times
             MEAN'ST |     1 times
              THEE-- |     2 times
             COME:-- |     1 times
              THRIVE |     1 times
              SOUL-- |     1 times
               WORSE |     3 times
                WANT |     2 times
              TOWARD |     3 times
          SCHOOLBOYS |     1 times
               BOOKS |     1 times
              SCHOOL |     1 times
            RETIRING |     1 times
                HIST |     1 times
                HIST |     1 times
          FALCONER'S |     1 times
                LURE |     1 times
       TASSEL-GENTLE |     1 times
             BONDAGE |     1 times
              HOARSE |     2 times
               ALOUD |     2 times
                CAVE |     2 times
                ECHO |     1 times
              TONGUE |    10 times
          REPETITION |     1 times
        SILVER-SWEET |     1 times
             TONGUES |     1 times
             SOFTEST |     1 times
           ATTENDING |     1 times
             O'CLOCK |     2 times
                FAIL |     2 times
              FORGOT |     2 times
         REMEMBERING |     1 times
             COMPANY |     6 times
          FORGETTING |     1 times
              ALMOST |     3 times
            WANTON'S |     1 times
                BIRD |     2 times
                LETS |     1 times
                 HOP |     1 times
            PRISONER |     1 times
             TWISTED |     1 times
               GYVES |     1 times
                SILK |     2 times
              THREAD |     1 times
              PLUCKS |     1 times
      LOVING-JEALOUS |     1 times
          CHERISHING |     1 times
             PARTING |     1 times
              SORROW |     8 times
              MORROW |     5 times
             GHOSTLY |     4 times
            FATHER'S |     4 times
                CELL |    17 times
                HELP |    18 times
               CRAVE |     1 times
                 HAP |     2 times
               FRIAR |    97 times
          LAURENCE'S |     5 times
            LAURENCE |    67 times
              BASKET |     1 times
           GREY-EYED |     1 times
                MORN |     3 times
              SMILES |     2 times
            FROWNING |     1 times
          CHEQUERING |     1 times
             EASTERN |     1 times
             STREAKS |     2 times
             FLECKED |     1 times
            DARKNESS |     1 times
            DRUNKARD |     1 times
               REELS |     1 times
               DAY'S |     3 times
                PATH |     1 times
             TITAN'S |     1 times
              WHEELS |     1 times
             ADVANCE |     1 times
               CHEER |     2 times
                DANK |     1 times
                 DRY |     4 times
             UP-FILL |     1 times
               OSIER |     1 times
                CAGE |     1 times
                OURS |     2 times
             BALEFUL |     1 times
               WEEDS |     2 times
     PRECIOUS-JUICED |     1 times
             FLOWERS |     6 times
            NATURE'S |     2 times
                TOMB |    11 times
             BURYING |     1 times
                WOMB |     3 times
                WOMB |     1 times
              DIVERS |     1 times
             SUCKING |     1 times
             NATURAL |     2 times
             VIRTUES |     1 times
              MICKLE |     1 times
            POWERFUL |     1 times
               HERBS |     2 times
              PLANTS |     1 times
              STONES |     1 times
           QUALITIES |     1 times
             SPECIAL |     1 times
               AUGHT |     2 times
            STRAIN'D |     1 times
             REVOLTS |     1 times
           STUMBLING |     1 times
               ABUSE |     1 times
              VIRTUE |     1 times
              ITSELF |     6 times
               TURNS |     3 times
                VICE |     2 times
          MISAPPLIED |     1 times
           SOMETIMES |     2 times
              ACTION |     1 times
           DIGNIFIED |     1 times
              INFANT |     1 times
                RIND |     1 times
           RESIDENCE |     1 times
            MEDICINE |     1 times
               SMELT |     1 times
              CHEERS |     1 times
                EACH |     2 times
              TASTED |     1 times
               SLAYS |     1 times
              SENSES |     1 times
             OPPOSED |     1 times
               KINGS |     1 times
              ENCAMP |     1 times
              WORSER |     2 times
         PREDOMINANT |     1 times
                FULL |    10 times
              CANKER |     1 times
                EATS |     1 times
               PLANT |     1 times
          BENEDICITE |     1 times
            SALUTETH |     1 times
              ARGUES |     1 times
         DISTEMPER'D |     1 times
               KEEPS |     4 times
               MAN'S |     5 times
              LODGES |     1 times
           UNBRUISED |     1 times
           UNSTUFF'D |     1 times
               COUCH |     1 times
               LIMBS |     2 times
               REIGN |     2 times
           EARLINESS |     1 times
              ASSURE |     1 times
           UP-ROUSED |     1 times
      DISTEMPERATURE |     1 times
             SWEETER |     1 times
              NAME'S |     2 times
            FEASTING |     2 times
             WOUNDED |     1 times
             WOUNDED |     1 times
            REMEDIES |     1 times
              PHYSIC |     1 times
              HATRED |     1 times
                  LO |     3 times
        INTERCESSION |     1 times
              STEADS |     1 times
               PLAIN |     1 times
              HOMELY |     1 times
               DRIFT |     2 times
            RIDDLING |     2 times
          CONFESSION |     3 times
               FINDS |     2 times
             PLAINLY |     1 times
            COMBINED |     1 times
             COMBINE |     1 times
                 MET |     4 times
               WOO'D |     1 times
             FRANCIS |     2 times
            FORSAKEN |     1 times
               TRULY |     3 times
                JESU |     3 times
               MARIA |     1 times
                DEAL |     2 times
               BRINE |     1 times
              SALLOW |     1 times
              CHEEKS |     6 times
                SALT |     2 times
               WATER |     2 times
              THROWN |     1 times
              SEASON |     1 times
              CLEARS |     1 times
              GROANS |     2 times
                RING |     5 times
               STAIN |     1 times
                WOES |     7 times
                WOES |     1 times
             CHANGED |     2 times
             THERE'S |     5 times
             CHID'ST |     1 times
              DOTING |     2 times
               PUPIL |     1 times
              BAD'ST |     1 times
               CHIDE |     5 times
               ALLOW |     1 times
                ROTE |     1 times
               SPELL |     1 times
             WAVERER |     1 times
           ASSISTANT |     1 times
            ALLIANCE |     1 times
         HOUSEHOLDS' |     1 times
             RANCOUR |     1 times
                PURE |     3 times
               HASTE |    14 times
                SLOW |     4 times
             STUMBLE |     1 times
               DEVIL |     3 times
        HARD-HEARTED |     1 times
               WENCH |     3 times
            TORMENTS |     1 times
                SURE |     4 times
              LETTER |    12 times
           CHALLENGE |     2 times
               WRITE |     2 times
            LETTER'S |     1 times
               DARED |     1 times
             STABBED |     1 times
               WHITE |     2 times
             WENCH'S |     1 times
           LOVE-SONG |     1 times
                 PIN |     1 times
               CLEFT |     1 times
           BOW-BOY'S |     1 times
          BUTT-SHAFT |     1 times
                CATS |     2 times
          COURAGEOUS |     1 times
             CAPTAIN |     1 times
         COMPLIMENTS |     1 times
              FIGHTS |     2 times
          PRICK-SONG |     1 times
            DISTANCE |     1 times
          PROPORTION |     1 times
               RESTS |     1 times
               MINIM |     1 times
               THIRD |     3 times
             BUTCHER |     1 times
              BUTTON |     1 times
            DUELLIST |     1 times
            DUELLIST |     1 times
            IMMORTAL |     3 times
             PASSADO |     2 times
               PUNTO |     1 times
             REVERSO |     1 times
                 HAI |     1 times
                 POX |     1 times
             LISPING |     1 times
           AFFECTING |     1 times
        FANTASTICOES |     1 times
              TUNERS |     1 times
             ACCENTS |     1 times
                 'BY |     1 times
                TALL |     1 times
             WHORE!' |     1 times
          LAMENTABLE |     5 times
           AFFLICTED |     1 times
               FLIES |     3 times
     FASHION-MONGERS |     1 times
        PERDONA-MI'S |     1 times
                EASE |     2 times
               BENCH |     1 times
               BONES |     7 times
               BONES |     1 times
                 ROE |     1 times
               DRIED |     1 times
             HERRING |     1 times
           FISHIFIED |     1 times
             NUMBERS |     1 times
            PETRARCH |     1 times
              FLOWED |     1 times
               LAURA |     1 times
       KITCHEN-WENCH |     1 times
            BE-RHYME |     1 times
                DIDO |     1 times
               DOWDY |     1 times
           CLEOPATRA |     1 times
               GIPSY |     1 times
               HELEN |     1 times
                HERO |     1 times
            HILDINGS |     1 times
             HARLOTS |     1 times
              THISBE |     1 times
                GREY |     2 times
                 BON |     1 times
                JOUR |     1 times
              FRENCH |     2 times
          SALUTATION |     1 times
                SLOP |     1 times
         COUNTERFEIT |     2 times
              FAIRLY |     2 times
                SHIP |     1 times
                SLIP |     1 times
            CONCEIVE |     1 times
              STRAIN |     1 times
            COURTESY |     3 times
          CONSTRAINS |     1 times
                HAMS |     1 times
            COURT'SY |     1 times
              KINDLY |     1 times
           COURTEOUS |     3 times
          EXPOSITION |     1 times
                PINK |     1 times
                PINK |     1 times
                PUMP |     2 times
            FLOWERED |     1 times
              SINGLE |     1 times
                SOLE |     3 times
              REMAIN |     2 times
             WEARING |     2 times
            SINGULAR |     2 times
        SINGLE-SOLED |     1 times
              SOLELY |     1 times
          SINGLENESS |     1 times
               FAINT |     3 times
              SWITCH |     2 times
               SPURS |     1 times
               SPURS |     1 times
          WILD-GOOSE |     2 times
               CHASE |     1 times
               WHOLE |     3 times
               GOOSE |     5 times
               GOOSE |     1 times
            SWEETING |     1 times
               SHARP |     2 times
               SAUCE |     1 times
            CHEVERIL |     1 times
           STRETCHES |     1 times
                INCH |     1 times
              NARROW |     1 times
                 ELL |     1 times
               BROAD |     3 times
             STRETCH |     1 times
            'BROAD;' |     1 times
               ADDED |     1 times
              PROVES |     1 times
                WIDE |     3 times
            GROANING |     1 times
            SOCIABLE |     1 times
          DRIVELLING |     1 times
                RUNS |     1 times
             LOLLING |     1 times
              BAUBLE |     1 times
                HOLE |     1 times
                STOP |     4 times
                STOP |     1 times
            DESIREST |     1 times
                HAIR |     4 times
               LARGE |     1 times
            DECEIVED |     2 times
               DEPTH |     1 times
               MEANT |     2 times
              OCCUPY |     1 times
            ARGUMENT |     1 times
              GOODLY |     1 times
                GEAR |     2 times
               PETER |    26 times
               SHIRT |     1 times
               SMOCK |     1 times
                 FAN |     2 times
               FAN'S |     1 times
                 DEN |     3 times
         GENTLEWOMAN |     4 times
               BAWDY |     1 times
                DIAL |     1 times
                NOON |     1 times
                 MAR |     1 times
               TROTH |     2 times
                'FOR |     1 times
               MAR,' |     1 times
               OLDER |     1 times
            YOUNGEST |     1 times
               FAULT |     4 times
                 YEA |     2 times
               WORST |     1 times
                  I' |     4 times
          CONFIDENCE |     1 times
              INDITE |     1 times
                BAWD |     2 times
                BAWD |     1 times
                HARE |     4 times
                HARE |     1 times
              LENTEN |     1 times
                 PIE |     1 times
           SOMETHING |     4 times
               STALE |     1 times
                HOAR |     4 times
               SPENT |     3 times
               SINGS |     3 times
                MEAT |     3 times
               SCORE |     1 times
               HOARS |     1 times
              DINNER |     3 times
             SINGING |     1 times
               'LADY |     1 times
              LADY.' |     1 times
            MERCHANT |     1 times
              ROPERY |     1 times
              MINUTE |     4 times
               MONTH |     2 times
             LUSTIER |     1 times
               JACKS |     1 times
              SCURVY |     2 times
               KNAVE |     4 times
         FLIRT-GILLS |     1 times
        SKAINS-MATES |     1 times
              SUFFER |     1 times
            OCCASION |     3 times
               AFORE |     3 times
               VEXED |     1 times
             QUIVERS |     1 times
                TOLD |     3 times
              FOOL'S |     1 times
            PARADISE |     2 times
               GROSS |     1 times
            BEHAVIOR |     1 times
              DOUBLE |     1 times
             OFFERED |     1 times
             DEALING |     1 times
             COMMEND |     5 times
             PROTEST |     3 times
              JOYFUL |     5 times
       GENTLEMANLIKE |     1 times
               OFFER |     2 times
              DEVISE |     3 times
           LAURENCE' |     5 times
             SHRIVED |     1 times
               PAINS |     2 times
               PENNY |     1 times
              BEHIND |     2 times
               ABBEY |     1 times
               BRING |    11 times
               CORDS |     6 times
             TACKLED |     1 times
               STAIR |     1 times
         TOP-GALLANT |     1 times
              CONVOY |     1 times
              TRUSTY |     1 times
                QUIT |     1 times
               BLESS |     2 times
                HARK |     4 times
              SAY'ST |     3 times
             PUTTING |     1 times
               STEEL |     3 times
            SWEETEST |     3 times
          LADY--LORD |     1 times
             PRATING |     1 times
           THING:--O |     1 times
            NOBLEMAN |     1 times
               KNIFE |     4 times
              ABOARD |     1 times
                LIEF |     1 times
                TOAD |     2 times
                TOAD |     1 times
            PROPERER |     1 times
               CLOUT |     1 times
              VERSAL |     1 times
            ROSEMARY |     3 times
                   R |     2 times
              MOCKER |     1 times
               DOG'S |     1 times
             THE--NO |     1 times
              BEGINS |     2 times
        LETTER:--AND |     1 times
         SENTENTIOUS |     1 times
               APACE |     2 times
               CLOCK |     1 times
                HALF |     4 times
            PROMISED |     1 times
           PERCHANCE |     1 times
                LAME |     1 times
             HERALDS |     1 times
            THOUGHTS |     3 times
                 TEN |     2 times
              FASTER |     1 times
               GLIDE |     1 times
               SUN'S |     1 times
             DRIVING |     1 times
             SHADOWS |     2 times
                OVER |     2 times
             LOURING |     1 times
               HILLS |     1 times
     NIMBLE-PINION'D |     1 times
               DOVES |     1 times
          WIND-SWIFT |     1 times
            HIGHMOST |     1 times
                HILL |     1 times
             JOURNEY |     1 times
                WARM |     4 times
            YOUTHFUL |     3 times
               SWIFT |     3 times
              MOTION |     2 times
                BALL |     1 times
               BANDY |     1 times
               FOLKS |     1 times
               FEIGN |     1 times
            UNWIELDY |     1 times
               HONEY |     3 times
                NEWS |    15 times
                GATE |     1 times
           NURSE,--O |     1 times
             LOOK'ST |     2 times
             MERRILY |     1 times
             SHAMEST |     2 times
             PLAYING |     1 times
                SOUR |     4 times
             A-WEARY |     1 times
                 FIE |     6 times
                ACHE |     1 times
               JAUNT |     1 times
                 BAD |     3 times
        CIRCUMSTANCE |     2 times
              SIMPLE |     3 times
              EXCELS |     2 times
                BODY |     9 times
              TALKED |     1 times
                WAYS |     2 times
               DINED |     1 times
               ACHES |     1 times
              PIECES |     1 times
                  T' |     1 times
            SIDE,--O |     1 times
             BESHREW |     4 times
             SENDING |     1 times
               CATCH |     1 times
            JAUNTING |     1 times
               SORRY |     1 times
            HANDSOME |     1 times
    VIRTUOUS,--WHERE |     1 times
               ODDLY |     1 times
            REPLIEST |     1 times
               'YOUR |     1 times
            MOTHER?' |     1 times
               GOD'S |     3 times
            POULTICE |     1 times
              ACHING |     1 times
        HENCEFORWARD |     2 times
            MESSAGES |     1 times
                COIL |     1 times
                 GOT |     3 times
                 HIE |     8 times
             HUSBAND |    12 times
              WANTON |     2 times
             THEY'LL |     1 times
              CHURCH |     9 times
              LADDER |     1 times
              BIRD'S |     1 times
                NEST |     2 times
              DRUDGE |     1 times
                  VI |     1 times
               SMILE |     2 times
             HEAVENS |     4 times
                AMEN |     3 times
                AMEN |     1 times
         COUNTERVAIL |     1 times
      LOVE-DEVOURING |     1 times
             VIOLENT |     2 times
            DELIGHTS |     2 times
                ENDS |     1 times
             TRIUMPH |     2 times
              POWDER |     3 times
             CONSUME |     1 times
           LOATHSOME |     3 times
       DELICIOUSNESS |     1 times
           CONFOUNDS |     1 times
            APPETITE |     1 times
          MODERATELY |     1 times
             ARRIVES |     1 times
               TARDY |     1 times
         EVERLASTING |     2 times
               FLINT |     1 times
            BESTRIDE |     1 times
            GOSSAMER |     1 times
               IDLES |     1 times
           CONFESSOR |     2 times
              THANKS |     3 times
              HEAP'D |     1 times
               SKILL |     1 times
              BLAZON |     1 times
             SWEETEN |     1 times
           NEIGHBOUR |     1 times
             MUSIC'S |     1 times
              UNFOLD |     1 times
            IMAGINED |     1 times
           HAPPINESS |     2 times
             RECEIVE |     1 times
             CONCEIT |     2 times
              MATTER |     5 times
            ORNAMENT |     2 times
             BEGGARS |     1 times
               WORTH |     1 times
              EXCESS |     1 times
                 SUM |     1 times
                 SUM |     1 times
                WORK |     4 times
         INCORPORATE |     1 times
                PAGE |    11 times
              RETIRE |     1 times
               SCAPE |     2 times
               BRAWL |     2 times
            STIRRING |     1 times
              ENTERS |     2 times
            CONFINES |     1 times
              TAVERN |     1 times
               CLAPS |     1 times
               TABLE |     1 times
                'GOD |     1 times
              THEE!' |     1 times
           OPERATION |     1 times
               DRAWS |     2 times
              DRAWER |     1 times
                JACK |     2 times
                MOOD |     1 times
               ITALY |     1 times
               MOODY |     1 times
               MOODY |     1 times
             SHORTLY |     1 times
               BEARD |     1 times
            CRACKING |     1 times
                NUTS |     1 times
              REASON |     5 times
               HAZEL |     1 times
                 SPY |     2 times
                 FUN |     1 times
            QUARRELS |     1 times
                 EGG |     2 times
              BEATEN |     1 times
               ADDLE |     1 times
         QUARRELLING |     2 times
          QUARRELLED |     1 times
            COUGHING |     1 times
             WAKENED |     1 times
                LAIN |     3 times
             DOUBLET |     1 times
              EASTER |     1 times
               TYING |     1 times
              RIBAND |     1 times
               TUTOR |     1 times
                 APT |     3 times
                 BUY |     3 times
          FEE-SIMPLE |     2 times
             QUARTER |     1 times
              COUPLE |     1 times
          CONSORT'ST |     1 times
            ROMEO,-- |     1 times
             CONSORT |     3 times
           MINSTRELS |     1 times
           MINSTRELS |     1 times
            DISCORDS |     3 times
         FIDDLESTICK |     1 times
             'ZOUNDS |     2 times
               HAUNT |     1 times
              COLDLY |     1 times
          GRIEVANCES |     1 times
               BUDGE |     1 times
              HANGED |     1 times
               FIELD |     2 times
               HE'LL |     2 times
            FOLLOWER |     1 times
             WORSHIP |     2 times
              'MAN.' |     1 times
              AFFORD |     3 times
         THIS,--THOU |     1 times
        APPERTAINING |     1 times
            INJURIES |     1 times
             INJURED |     1 times
     CAPULET,--WHICH |     1 times
              DEARLY |     2 times
            OWN,--BE |     1 times
                CALM |     3 times
       DISHONOURABLE |     1 times
          SUBMISSION |     1 times
                ALLA |     1 times
            STOCCATA |     1 times
             CARRIES |     1 times
         RAT-CATCHER |     1 times
           HEREAFTER |     2 times
             DRYBEAT |     1 times
               EIGHT |     1 times
               PLUCK |     2 times
             PITCHER |     1 times
             DRAWING |     2 times
             FORBEAR |     2 times
             OUTRAGE |     2 times
           EXPRESSLY |     1 times
           FORBIDDEN |     1 times
            BANDYING |     1 times
               STABS |     2 times
           FOLLOWERS |     1 times
              PLAGUE |     3 times
                SPED |     1 times
             SCRATCH |     2 times
             SCRATCH |     1 times
             SURGEON |     1 times
             COURAGE |     1 times
         CHURCH-DOOR |     1 times
       ENOUGH,'TWILL |     1 times
            PEPPERED |     1 times
                 RAT |     1 times
                 CAT |     2 times
            BRAGGART |     1 times
               ROGUE |     1 times
          ARITHMETIC |     1 times
             THOUGHT |     8 times
              WORMS' |     1 times
             SOUNDLY |     2 times
            PRINCE'S |     5 times
                ALLY |     1 times
              FRIEND |    13 times
              MORTAL |     2 times
              BEHALF |     1 times
          REPUTATION |     1 times
             STAIN'D |     2 times
            TYBALT'S |     9 times
    SLANDER,--TYBALT |     1 times
          EFFEMINATE |     1 times
              TEMPER |     2 times
            SOFTEN'D |     1 times
            VALOUR'S |     1 times
               BRAVE |     2 times
          MERCUTIO'S |     5 times
             GALLANT |     2 times
             ASPIRED |     1 times
                FATE |     1 times
              DEPEND |     1 times
             FURIOUS |     1 times
               ALIVE |     2 times
               SLAIN |    17 times
          RESPECTIVE |     1 times
              LENITY |     1 times
           FIRE-EYED |     1 times
                FURY |     3 times
             CONDUCT |     3 times
              GAVEST |     1 times
             STAYING |     1 times
            WRETCHED |     3 times
           DETERMINE |     2 times
               FALLS |     6 times
              AMAZED |     2 times
                DOOM |     6 times
               TAKEN |     2 times
           FORTUNE'S |     2 times
                   & |     2 times
                   C |     2 times
              KILL'D |     7 times
            MURDERER |     3 times
              CHARGE |     3 times
             PRINCES |     1 times
                OBEY |     2 times
            ATTENDED |     1 times
               WIVES |     1 times
           BEGINNERS |     1 times
            DISCOVER |     1 times
             UNLUCKY |     2 times
                SLEW |     5 times
           BROTHER'S |     2 times
               SPILT |     1 times
                SHED |     2 times
                SLAY |     4 times
             BETHINK |     2 times
                NICE |     2 times
         DISPLEASURE |     1 times
             UTTERED |     1 times
              HUMBLY |     1 times
               BOW'D |     1 times
               TRUCE |     1 times
              UNRULY |     1 times
              SPLEEN |     1 times
                DEAF |     2 times
               TILTS |     1 times
            PIERCING |     1 times
              DEADLY |     3 times
               POINT |     4 times
               POINT |     1 times
             MARTIAL |     1 times
               SENDS |     1 times
           DEXTERITY |     1 times
             RETORTS |     1 times
               CRIES |     3 times
               'HOLD |     1 times
              PART!' |     1 times
             SWIFTER |     1 times
               AGILE |     1 times
              POINTS |     1 times
              'TWIXT |     2 times
               STOUT |     2 times
               NEWLY |     2 times
         ENTERTAIN'D |     1 times
             REVENGE |     1 times
                  'T |     1 times
                FELL |     1 times
                 BEG |     4 times
             JUSTICE |     1 times
               PRICE |     2 times
                 OWE |     1 times
           CONCLUDES |     1 times
             OFFENCE |     1 times
         IMMEDIATELY |     2 times
               EXILE |     6 times
            INTEREST |     1 times
              HATE'S |     1 times
          PROCEEDING |     1 times
          A-BLEEDING |     1 times
              AMERCE |     1 times
              REPENT |     2 times
                LOSS |     4 times
            PLEADING |     1 times
             EXCUSES |     1 times
             PRAYERS |     1 times
            PURCHASE |     1 times
              ABUSES |     1 times
               MERCY |     5 times
             MURDERS |     3 times
           PARDONING |     1 times
              GALLOP |     1 times
        FIERY-FOOTED |     1 times
              STEEDS |     1 times
            PHOEBUS' |     1 times
             LODGING |     2 times
            PHAETHON |     1 times
                WEST |     1 times
              CLOUDY |     1 times
             CURTAIN |     1 times
     LOVE-PERFORMING |     1 times
           RUNAWAY'S |     1 times
                WINK |     1 times
                LEAP |     2 times
                ARMS |     2 times
            UNTALK'D |     1 times
              UNSEEN |     1 times
             AMOROUS |     2 times
               RITES |     1 times
              AGREES |     1 times
        SOBER-SUITED |     1 times
              MATRON |     1 times
                LOSE |     2 times
             WINNING |     1 times
              PLAY'D |     1 times
           STAINLESS |     1 times
         MAIDENHOODS |     1 times
                HOOD |     3 times
            UNMANN'D |     1 times
              BATING |     1 times
              MANTLE |     1 times
               ACTED |     1 times
             MODESTY |     3 times
              WHITER |     1 times
                SNOW |     1 times
             RAVEN'S |     1 times
        BLACK-BROW'D |     1 times
              GARISH |     1 times
              BOUGHT |     1 times
             MANSION |     2 times
           POSSESS'D |     2 times
                SOLD |     2 times
             ENJOY'D |     1 times
             TEDIOUS |     2 times
            FESTIVAL |     2 times
           IMPATIENT |     1 times
               ROBES |     2 times
              BRINGS |     2 times
            HEAVENLY |     1 times
           ELOQUENCE |     1 times
              THROWS |     1 times
               WRING |     1 times
          WELL-A-DAY |     2 times
              UNDONE |     1 times
              UNDONE |     1 times
             TORMENT |     1 times
              ROAR'D |     1 times
              DISMAL |     2 times
                'I,' |     1 times
                BARE |     3 times
               VOWEL |     1 times
                 'I' |     2 times
       DEATH-DARTING |     1 times
          COCKATRICE |     1 times
                'I.' |     1 times
              SOUNDS |     1 times
                WEAL |     1 times
             EYES,-- |     1 times
         MARK!--HERE |     1 times
               MANLY |     1 times
               CORSE |     6 times
               CORSE |     1 times
               ASHES |     2 times
            BEDAUB'D |     1 times
          GORE-BLOOD |     1 times
            SWOUNDED |     1 times
            BANKRUPT |     1 times
              RESIGN |     1 times
               PRESS |     2 times
                BIER |     2 times
         SLAUGHTER'D |     5 times
          DEAR-LOVED |     1 times
              DEARER |     1 times
            DREADFUL |     1 times
             TRUMPET |     1 times
             GENERAL |     2 times
              LIVING |     5 times
            BANISHED |     7 times
            BANISHED |     1 times
             SERPENT |     1 times
           FLOWERING |     1 times
              DRAGON |     1 times
           BEAUTIFUL |     1 times
               FIEND |     3 times
           ANGELICAL |     1 times
      DOVE-FEATHER'D |     1 times
               RAVEN |     1 times
    WOLVISH-RAVENING |     1 times
            DIVINEST |     1 times
                JUST |     2 times
            OPPOSITE |     1 times
              JUSTLY |     1 times
             SEEM'ST |     1 times
              DAMNED |     4 times
               BOWER |     1 times
               MORAL |     1 times
          CONTAINING |     1 times
              DECEIT |     1 times
            GORGEOUS |     1 times
              PALACE |     2 times
             HONESTY |     1 times
            PERJURED |     1 times
              NAUGHT |     1 times
         DISSEMBLERS |     1 times
                AQUA |     2 times
               VITAE |     2 times
           BLISTER'D |     1 times
                BORN |     3 times
             ASHAMED |     1 times
              THRONE |     2 times
             CROWN'D |     1 times
             MONARCH |     1 times
           UNIVERSAL |     1 times
               BEAST |     3 times
         THREE-HOURS |     1 times
             MANGLED |     2 times
              NATIVE |     2 times
              SPRING |     2 times
           TRIBUTARY |     1 times
               DROPS |     1 times
              BELONG |     1 times
           MISTAKING |     1 times
            MURDER'D |     3 times
              MEMORY |     1 times
              GUILTY |     2 times
               DEEDS |     1 times
            SINNERS' |     1 times
               MINDS |     1 times
             'TYBALT |     1 times
   ROMEO--BANISHED;' |     1 times
         'BANISHED,' |     1 times
         'BANISHED,' |     1 times
             TYBALTS |     1 times
          FELLOWSHIP |     1 times
              NEEDLY |     1 times
              RANK'D |     1 times
            FOLLOW'D |     1 times
           'TYBALT'S |     1 times
              DEAD,' |     1 times
              MODERN |     1 times
        LAMENTATIONS |     1 times
           REAR-WARD |     1 times
           FOLLOWING |     1 times
              'ROMEO |     2 times
          BANISHED,' |     1 times
          BANISHED!' |     1 times
               LIMIT |     1 times
              WORD'S |     1 times
             WEEPING |     4 times
             WAILING |     1 times
                WASH |     2 times
              WOUNDS |     1 times
              THEIRS |     1 times
          BANISHMENT |     6 times
               ROPES |     1 times
            BEGUILED |     2 times
              EXILED |     1 times
             HIGHWAY |     1 times
      MAIDEN-WIDOWED |     1 times
         WEDDING-BED |     1 times
                 WOT |     1 times
          AFFLICTION |     1 times
           ENAMOUR'D |     1 times
               PARTS |     2 times
              WEDDED |     2 times
            CALAMITY |     1 times
        ACQUAINTANCE |     1 times
            FAMILIAR |     1 times
             TIDINGS |     3 times
           DOOMS-DAY |     2 times
             GENTLER |     1 times
            VANISH'D |     1 times
              BODY'S |     1 times
              BODY'S |     1 times
            MERCIFUL |     2 times
            'DEATH;' |     1 times
              TERROR |     2 times
       'BANISHMENT.' |     1 times
           PURGATORY |     1 times
      HENCE-BANISHED |     1 times
            BANISH'D |     5 times
             WORLD'S |     2 times
          MIS-TERM'D |     1 times
             CALLING |     1 times
             CUTT'ST |     1 times
                 AXE |     1 times
             SMILEST |     1 times
              STROKE |     1 times
      UNTHANKFULNESS |     1 times
              TAKING |     2 times
              RUSH'D |     1 times
              TURN'D |     1 times
               SEEST |     2 times
            UNWORTHY |     2 times
            VALIDITY |     1 times
           COURTSHIP |     1 times
       CARRION-FLIES |     1 times
               SEIZE |     1 times
              WONDER |     2 times
            JULIET'S |     6 times
            BLESSING |     1 times
            THINKING |     1 times
                FREE |     2 times
               MIX'D |     1 times
        SHARP-GROUND |     1 times
          'BANISHED' |     3 times
     ME?--'BANISHED' |     1 times
            HOWLINGS |     1 times
              DIVINE |     1 times
        SIN-ABSOLVER |     1 times
           PROFESS'D |     1 times
              MANGLE |     1 times
              ARMOUR |     1 times
         ADVERSITY'S |     1 times
                MILK |     1 times
          PHILOSOPHY |     3 times
                HANG |     5 times
            DISPLANT |     1 times
             REVERSE |     1 times
            PREVAILS |     1 times
              MADMEN |     1 times
             DISPUTE |     1 times
              ESTATE |     1 times
            MURDERED |     1 times
             MIGHTST |     1 times
             MIGHTST |     1 times
              UNMADE |     1 times
            KNOCKING |     4 times
              KNOCKS |     2 times
           HEARTSICK |     1 times
           MIST-LIKE |     1 times
              INFOLD |     1 times
              SEARCH |     4 times
               WHO'S |     2 times
               STUDY |     1 times
          SIMPLENESS |     1 times
              ERRAND |     1 times
               WOFUL |     8 times
            SYMPATHY |     1 times
         PREDICAMENT |     1 times
          BLUBBERING |     1 times
          BLUBBERING |     1 times
                RISE |     1 times
             DEATH'S |     3 times
             SPAKEST |     1 times
           CHILDHOOD |     1 times
             REMOVED |     1 times
           CONCEAL'D |     1 times
           CANCELL'D |     1 times
               WEEPS |     3 times
               WEEPS |     1 times
               LEVEL |     1 times
                 GUN |     1 times
             ANATOMY |     1 times
               LODGE |     1 times
                SACK |     1 times
            WOMANISH |     2 times
                WILD |     3 times
                ACTS |     1 times
              DENOTE |     1 times
        UNREASONABLE |     1 times
            UNSEEMLY |     1 times
               ORDER |     2 times
            TEMPER'D |     1 times
               DOING |     2 times
             RAIL'ST |     1 times
              USURER |     1 times
           ABOUND'ST |     1 times
               USEST |     1 times
              BEDECK |     1 times
          DIGRESSING |     1 times
              VALOUR |     2 times
              HOLLOW |     3 times
             PERJURY |     1 times
             KILLING |     1 times
               VOW'D |     1 times
             CHERISH |     1 times
           MISSHAPEN |     1 times
            SKITLESS |     1 times
               FLASK |     1 times
               AFIRE |     1 times
           IGNORANCE |     1 times
         DISMEMBER'D |     1 times
             DEFENCE |     1 times
               ROUSE |     3 times
              LATELY |     1 times
             SLEW'ST |     1 times
          THREATEN'D |     1 times
             BECOMES |     1 times
                PACK |     1 times
           BLESSINGS |     1 times
              COURTS |     1 times
               ARRAY |     2 times
          MISBEHAVED |     1 times
              SULLEN |     2 times
             POUT'ST |     1 times
                HEED |     1 times
                HEED |     1 times
           MISERABLE |     2 times
             DECREED |     1 times
              ASCEND |     1 times
              MANTUA |    12 times
               BLAZE |     1 times
           RECONCILE |     1 times
             WENT'ST |     1 times
         LAMENTATION |     1 times
              HASTEN |     1 times
              COMING |     4 times
              STAY'D |     3 times
            LEARNING |     1 times
               GROWS |     2 times
             REVIVED |     2 times
           DISGUISED |     1 times
             SOJOURN |     1 times
             SIGNIFY |     1 times
             CHANCES |     1 times
              FALL'N |     1 times
           UNLUCKILY |     1 times
            I:--WELL |     1 times
             PROMISE |     1 times
               A-BED |     1 times
               MEW'D |     1 times
           HEAVINESS |     2 times
             CHILD'S |     1 times
            RESPECTS |     1 times
               DOUBT |     4 times
            ACQUAINT |     1 times
           WEDNESDAY |     3 times
              NEXT-- |     1 times
              MONDAY |     1 times
              MONDAY |     1 times
            THURSDAY |    13 times
            THURSDAY |     1 times
                EARL |     1 times
             ADO,--A |     1 times
          CARELESSLY |     1 times
               REVEL |     1 times
               DOZEN |     1 times
         WEDDING-DAY |     2 times
         NIGHTINGALE |     3 times
                LARK |     6 times
             PIERCED |     1 times
             NIGHTLY |     4 times
                 YON |     3 times
    POMEGRANATE-TREE |     1 times
              HERALD |     1 times
                LACE |     1 times
            SEVERING |     1 times
             CANDLES |     1 times
              JOCUND |     1 times
              TIPTOE |     1 times
               MISTY |     1 times
            MOUNTAIN |     1 times
                TOPS |     1 times
           DAY-LIGHT |     1 times
              METEOR |     1 times
             EXHALES |     1 times
        TORCH-BEARER |     1 times
             NEED'ST |     1 times
               TA'EN |     2 times
           MORNING'S |     3 times
              REFLEX |     1 times
           CYNTHIA'S |     1 times
               NOTES |     1 times
              VAULTY |     1 times
               WILLS |     1 times
                TUNE |     1 times
           STRAINING |     1 times
               HARSH |     1 times
          UNPLEASING |     1 times
              SHARPS |     1 times
            DIVISION |     1 times
            DIVIDETH |     1 times
              VOICES |     1 times
              AFFRAY |     1 times
             HUNTING |     1 times
           HUNT'S-UP |     1 times
                WARY |     1 times
             DESCEND |     2 times
               GOETH |     1 times
                OMIT |     1 times
         OPPORTUNITY |     1 times
              CONVEY |     1 times
           GREETINGS |     1 times
        ILL-DIVINING |     1 times
            METHINKS |     3 times
               BELOW |     1 times
              BOTTOM |     2 times
               FAILS |     1 times
              DRINKS |     2 times
              FICKLE |     2 times
              FICKLE |     1 times
            RENOWN'D |     1 times
                HOPE |     4 times
        UNACCUSTOM'D |     3 times
            PROCURES |     1 times
            EVERMORE |     2 times
            COUSIN'S |     3 times
             COULDST |     1 times
             COULDST |     1 times
             FEELING |     1 times
             FEELING |     1 times
             WEEP'ST |     1 times
               MILES |     1 times
          ASUNDER.-- |     1 times
              GRIEVE |     1 times
             TRAITOR |     1 times
               REACH |     1 times
               VENGE |     1 times
           VENGEANCE |     2 times
            RUNAGATE |     1 times
                DRAM |     2 times
         HIM--DEAD-- |     1 times
             RECEIPT |     1 times
             THEREOF |     1 times
              ABHORS |     1 times
               NAMED |     1 times
               WREAK |     1 times
                BORE |     2 times
               NEEDY |     3 times
            LADYSHIP |     1 times
             CAREFUL |     1 times
              SORTED |     1 times
           EXPECT'ST |     1 times
              LOOK'D |     1 times
             PETER'S |     3 times
             HAPPILY |     2 times
                 WED |     3 times
                SETS |     1 times
             DRIZZLE |     1 times
              SUNSET |     1 times
               RAINS |     1 times
           DOWNRIGHT |     1 times
             CONDUIT |     1 times
           SHOWERING |     1 times
      COUNTERFEIT'ST |     1 times
                BARK |     3 times
                 EBB |     1 times
                FLOW |     1 times
             SAILING |     1 times
               FLOOD |     1 times
              RAGING |     1 times
             OVERSET |     1 times
      TEMPEST-TOSSED |     1 times
           DELIVER'D |     1 times
              DECREE |     1 times
               PROUD |     4 times
               BLEST |     2 times
             WROUGHT |     2 times
              WORTHY |     1 times
          BRIDEGROOM |     4 times
            THANKFUL |     1 times
            THANKFUL |     1 times
          CHOP-LOGIC |     1 times
            'PROUD,' |     1 times
                  'I |     2 times
               YOU,' |     1 times
               NOT;' |     1 times
                'NOT |     1 times
             PROUD,' |     1 times
              MINION |     1 times
           THANKINGS |     1 times
              PROUDS |     1 times
              FETTLE |     1 times
              JOINTS |     3 times
             'GAINST |     1 times
                DRAG |     1 times
              HURDLE |     1 times
      GREEN-SICKNESS |     1 times
             CARRION |     1 times
             BAGGAGE |     2 times
         TALLOW-FACE |     1 times
         DISOBEDIENT |     2 times
               REPLY |     1 times
                ITCH |     1 times
              SCARCE |     1 times
               CURSE |     1 times
             HILDING |     1 times
               BLAME |     1 times
                RATE |     2 times
            PRUDENCE |     1 times
             SMATTER |     1 times
             GOSSIPS |     1 times
             TREASON |     1 times
            MUMBLING |     1 times
               UTTER |     1 times
             GRAVITY |     1 times
            GOSSIP'S |     1 times
                BOWL |     1 times
               BREAD |     1 times
                TIDE |     1 times
            PROVIDED |     1 times
           PARENTAGE |     1 times
               NOBLY |     1 times
             TRAIN'D |     1 times
             STUFF'D |     2 times
        PROPORTION'D |     1 times
               ONE'S |     1 times
              PULING |     1 times
             WHINING |     1 times
              MAMMET |     1 times
               'I'LL |     1 times
                ME.' |     1 times
               GRAZE |     1 times
                TO'T |     2 times
                ON'T |     2 times
              ADVISE |     1 times
              STARVE |     1 times
         ACKNOWLEDGE |     1 times
                SEES |     1 times
                WEEK |     2 times
              BRIDAL |     3 times
                 DIM |     2 times
            MONUMENT |     6 times
             GOD!--O |     1 times
           PREVENTED |     1 times
             LEAVING |     1 times
            PRACTISE |     1 times
          STRATAGEMS |     1 times
             SUBJECT |     1 times
               NEEDS |     4 times
             STEALTH |     1 times
           DISHCLOUT |     1 times
               EAGLE |     1 times
               QUICK |     2 times
              'TWERE |     1 times
            SPEAKEST |     1 times
           COMFORTED |     1 times
          MARVELLOUS |     1 times
          DISPLEASED |     1 times
            ABSOLVED |     1 times
           DAMNATION |     1 times
              WICKED |     1 times
           DISPRAISE |     1 times
             PRAISED |     1 times
               TWAIN |     2 times
              REMEDY |     3 times
               SLACK |     1 times
              UNEVEN |     1 times
        IMMODERATELY |     1 times
              COUNTS |     1 times
           DANGEROUS |     1 times
                SWAY |     1 times
              HASTES |     1 times
          INUNDATION |     1 times
              MINDED |     1 times
             SOCIETY |     1 times
              SLOW'D |     1 times
             CERTAIN |     1 times
                TEXT |     1 times
              ABUSED |     1 times
             VICTORY |     1 times
            WRONG'ST |     1 times
              REPORT |     1 times
             SLANDER |     1 times
               SPAKE |     1 times
               SPAKE |     1 times
           SLANDER'D |     1 times
             LEISURE |     2 times
             EVENING |     1 times
                MASS |     2 times
              SERVES |     1 times
             PENSIVE |     1 times
              SHIELD |     1 times
             STRAINS |     1 times
             COMPASS |     1 times
            PROROGUE |     1 times
             HEAR'ST |     3 times
             PREVENT |     2 times
          RESOLUTION |     1 times
           PRESENTLY |     3 times
              JOIN'D |     1 times
              SEAL'D |     2 times
               LABEL |     1 times
                DEED |     1 times
         TREACHEROUS |     1 times
              REVOLT |     1 times
    LONG-EXPERIENCED |     1 times
             PRESENT |     3 times
            EXTREMES |     1 times
              UMPIRE |     1 times
         ARBITRATING |     1 times
          COMMISSION |     1 times
               ISSUE |     1 times
            SPEAK'ST |     1 times
           EXECUTION |     1 times
              LIKELY |     1 times
           UNDERTAKE |     1 times
              COPEST |     1 times
              DAREST |     1 times
         BATTLEMENTS |     1 times
               TOWER |     1 times
            THIEVISH |     1 times
                LURK |     1 times
            SERPENTS |     1 times
               CHAIN |     1 times
             ROARING |     2 times
       CHARNEL-HOUSE |     1 times
        O'ER-COVER'D |     1 times
               QUITE |     2 times
            RATTLING |     1 times
               REEKY |     1 times
              SHANKS |     1 times
              YELLOW |     1 times
            CHAPLESS |     1 times
              SKULLS |     2 times
            NEW-MADE |     2 times
              SHROUD |     3 times
           UNSTAIN'D |     1 times
                VIAL |     2 times
           DISTILLED |     1 times
              LIQUOR |     1 times
               DRINK |     3 times
              DROWSY |     1 times
               PULSE |     1 times
            PROGRESS |     1 times
            SURCEASE |     1 times
              WARMTH |     1 times
             TESTIFY |     1 times
              LIVEST |     1 times
               ROSES |     2 times
                FADE |     1 times
                PALY |     1 times
               EYES' |     1 times
            DEPRIVED |     1 times
              SUPPLE |     1 times
          GOVERNMENT |     1 times
               STIFF |     2 times
               STARK |     1 times
            BORROW'D |     2 times
              SHRUNK |     1 times
            CONTINUE |     1 times
               FORTY |     2 times
               AWAKE |     2 times
            PLEASANT |     1 times
              MANNER |     1 times
             COUNTRY |     1 times
           UNCOVER'D |     1 times
               BORNE |     1 times
               VAULT |     9 times
             KINDRED |     1 times
              WAKING |     3 times
                 TOY |     1 times
               ABATE |     1 times
              ACTING |     1 times
          PROSPEROUS |     2 times
             RESOLVE |     1 times
               SPEED |     3 times
              INVITE |     1 times
                HIRE |     3 times
               COOKS |     1 times
                 TRY |     2 times
                LICK |     3 times
                COOK |     2 times
         UNFURNISHED |     1 times
            FORSOOTH |     1 times
             PEEVISH |     1 times
         SELF-WILL'D |     1 times
            HARLOTRY |     1 times
          HEADSTRONG |     1 times
             GADDING |     1 times
          OPPOSITION |     1 times
             BEHESTS |     1 times
            ENJOIN'D |     1 times
           PROSTRATE |     1 times
                KNOT |     1 times
                KNIT |     1 times
             BECOMED |     1 times
              BOUNDS |     1 times
                AS'T |     1 times
            REVEREND |     1 times
                CITY |     3 times
              CLOSET |     1 times
                SORT |     1 times
             NEEDFUL |     1 times
                 FIT |     2 times
             FURNISH |     1 times
           PROVISION |     1 times
                TUSH |     2 times
                DECK |     1 times
           HOUSEWIFE |     1 times
            WONDROUS |     1 times
             WAYWARD |     1 times
           RECLAIM'D |     1 times
             ATTIRES |     1 times
             ORISONS |     1 times
               CROSS |     2 times
                BUSY |     1 times
              CULL'D |     1 times
         NECESSARIES |     1 times
           BEHOVEFUL |     1 times
               KNOWS |     3 times
             THRILLS |     1 times
             FREEZES |     1 times
                HEAT |     1 times
             MIXTURE |     1 times
              LAYING |     2 times
              DAGGER |     7 times
              SUBTLY |     1 times
          MINISTER'D |     1 times
         DISHONOUR'D |     1 times
               TRIED |     1 times
                WAKE |     5 times
              REDEEM |     1 times
             STIFLED |     1 times
               MOUTH |     2 times
          HEALTHSOME |     1 times
            BREATHES |     1 times
           STRANGLED |     1 times
            HORRIBLE |     1 times
            TOGETHER |     1 times
            PLACE,-- |     1 times
          RECEPTACLE |     1 times
              BURIED |     4 times
           ANCESTORS |     1 times
              PACKED |     1 times
           FESTERING |     1 times
             SPIRITS |     1 times
           RESORT;-- |     1 times
              SMELLS |     1 times
             SHRIEKS |     1 times
          MANDRAKES' |     1 times
                TORN |     1 times
             HEARING |     2 times
              MAD:-- |     1 times
          DISTRAUGHT |     1 times
           ENVIRONED |     1 times
             HIDEOUS |     1 times
               FEARS |     1 times
               MADLY |     1 times
        FOREFATHER'S |     1 times
           KINSMAN'S |     1 times
                CLUB |     1 times
                DASH |     1 times
               GHOST |     1 times
             SEEKING |     1 times
                SPIT |     1 times
            RAPIER'S |     1 times
                KEYS |     1 times
              SPICES |     1 times
               DATES |     1 times
             QUINCES |     1 times
              PASTRY |     1 times
                COCK |     1 times
              CROW'D |     1 times
         CURFEW-BELL |     1 times
                RUNG |     1 times
               BAKED |     1 times
               MEATS |     1 times
            ANGELICA |     1 times
               SPARE |     1 times
                COST |     1 times
           COT-QUEAN |     1 times
            WATCHING |     2 times
                WHIT |     1 times
             WATCH'D |     1 times
              LESSER |     1 times
          MOUSE-HUNT |     1 times
             JEALOUS |     2 times
             JEALOUS |     1 times
                FOUR |     1 times
               SPITS |     1 times
                LOGS |     3 times
             BASKETS |     1 times
               DRIER |     1 times
             TROUBLE |     2 times
            WHORESON |     1 times
         LOGGER-HEAD |     1 times
               WAKEN |     1 times
                CHAT |     1 times
          SLUG-A-BED |     1 times
         SWEET-HEART |     1 times
         PENNYWORTHS |     1 times
             FORGIVE |     2 times
              FRIGHT |     1 times
             UNDRAWS |     1 times
             DRESS'D |     1 times
             CLOTHES |     1 times
              REVIVE |     1 times
            DECEASED |     1 times
             SETTLED |     1 times
           SEPARATED |     1 times
               FROST |     1 times
                WAIL |     1 times
                TIES |     1 times
          DEFLOWERED |     1 times
          SON-IN-LAW |     1 times
            ACCURSED |     1 times
             UNHAPPY |     2 times
             LASTING |     1 times
              LABOUR |     1 times
          PILGRIMAGE |     1 times
              SOLACE |     1 times
             CATCH'D |     1 times
            DIVORCED |     1 times
             WRONGED |     1 times
              SPITED |     1 times
          DETESTABLE |     2 times
            BEGUIL'D |     1 times
          OVERTHROWN |     1 times
          DISTRESSED |     1 times
               HATED |     1 times
            MARTYR'D |     1 times
       UNCOMFORTABLE |     1 times
                JOYS |     2 times
         CONFUSION'S |     1 times
          CONFUSIONS |     1 times
             ETERNAL |     1 times
           PROMOTION |     1 times
            ADVANCED |     3 times
              SEEING |     1 times
              SEEING |     1 times
               STICK |     1 times
              CUSTOM |     1 times
                BIDS |     1 times
              LAMENT |     1 times
            REASON'S |     1 times
           MERRIMENT |     1 times
            ORDAINED |     1 times
              OFFICE |     2 times
             FUNERAL |     1 times
         INSTRUMENTS |     2 times
          MELANCHOLY |     1 times
               BELLS |     1 times
              BURIAL |     1 times
              SOLEMN |     1 times
               HYMNS |     1 times
              DIRGES |     1 times
                LOUR |     1 times
            CROSSING |     1 times
            MUSICIAN |    14 times
               PIPES |     1 times
         GOODFELLOWS |     1 times
             PITIFUL |     2 times
             AMENDED |     1 times
            'HEART'S |     3 times
              EASE:' |     1 times
              EASE.' |     1 times
              EASE?' |     1 times
                 'MY |     1 times
               WOE:' |     1 times
                DUMP |     1 times
                DUMP |     1 times
               MONEY |     1 times
               GLEEK |     1 times
            MINSTREL |     1 times
    SERVING-CREATURE |     1 times
  SERVING-CREATURE'S |     1 times
                PATE |     1 times
           CROTCHETS |     1 times
                  RE |     2 times
                  FA |     1 times
                  FA |     1 times
            DRY-BEAT |     1 times
                IRON |     3 times
                IRON |     1 times
               'WHEN |     1 times
             GRIPING |     1 times
             DOLEFUL |     1 times
               DUMPS |     1 times
             OPPRESS |     1 times
            SOUND'-- |     1 times
             'SILVER |     2 times
              SOUND' |     2 times
              'MUSIC |     2 times
               SIMON |     1 times
             CATLING |     1 times
                HUGH |     1 times
              REBECK |     1 times
             SOUND,' |     2 times
               JAMES |     1 times
           SOUNDPOST |     1 times
              SINGER |     1 times
               'THEN |     1 times
              SPEEDY |     1 times
                LEND |     1 times
           REDRESS.' |     1 times
           PESTILENT |     1 times
               TARRY |     1 times
            MOURNERS |     1 times
          FLATTERING |     1 times
             PRESAGE |     1 times
             BOSOM'S |     1 times
             LIGHTLY |     1 times
               LIFTS |     1 times
            CHEERFUL |     1 times
              DREAMT |     2 times
              DEAD-- |     1 times
            THINK!-- |     1 times
             EMPEROR |     1 times
              BOOTED |     1 times
        VERONA!--HOW |     1 times
               FARES |     1 times
             CAPEL'S |     2 times
              ANGELS |     1 times
                 LOW |     1 times
           KINDRED'S |     2 times
                POST |     2 times
            BRINGING |     1 times
                DEFY |     2 times
                 INK |     1 times
         POST-HORSES |     1 times
              IMPORT |     2 times
        MISADVENTURE |     2 times
            MISCHIEF |     1 times
       APOTHECARY,-- |     1 times
          HEREABOUTS |     1 times
      DWELLS,--WHICH |     1 times
               NOTED |     1 times
            TATTER'D |     1 times
        OVERWHELMING |     1 times
             CULLING |     1 times
             SIMPLES |     1 times
              MEAGRE |     1 times
                SHOP |     2 times
            TORTOISE |     1 times
                HUNG |     1 times
           ALLIGATOR |     1 times
               SKINS |     1 times
          ILL-SHAPED |     1 times
              FISHES |     1 times
             SHELVES |     1 times
            BEGGARLY |     1 times
               BOXES |     1 times
             EARTHEN |     1 times
                POTS |     1 times
            BLADDERS |     1 times
               MUSTY |     1 times
               SEEDS |     1 times
            REMNANTS |     1 times
          PACKTHREAD |     1 times
               CAKES |     1 times
              THINLY |     1 times
           SCATTER'D |     1 times
              NOTING |     1 times
              PENURY |     1 times
                 'AN |     1 times
                SALE |     1 times
             CAITIFF |     1 times
                SELL |     4 times
               HIM.' |     1 times
             FORERUN |     1 times
             HOLIDAY |     1 times
            BEGGAR'S |     1 times
          APOTHECARY |     6 times
          APOTHECARY |     1 times
                LOUD |     1 times
              DUCATS |     1 times
       SOON-SPEEDING |     1 times
            DISPERSE |     1 times
          LIFE-WEARY |     1 times
               TAKER |     1 times
               TRUNK |     1 times
          DISCHARGED |     1 times
           VIOLENTLY |     1 times
               HASTY |     1 times
               FIRED |     1 times
               HURRY |     1 times
            CANNON'S |     1 times
               DRUGS |     2 times
            MANTUA'S |     1 times
              UTTERS |     1 times
        WRETCHEDNESS |     1 times
             FEAR'ST |     1 times
              FAMINE |     1 times
            STARVETH |     1 times
            CONTEMPT |     1 times
             BEGGARY |     1 times
             AFFORDS |     1 times
             POVERTY |     2 times
            CONSENTS |     1 times
              LIQUID |     1 times
            DISPATCH |     1 times
               SOULS |     1 times
           COMPOUNDS |     1 times
             CORDIAL |     1 times
          FRANCISCAN |     1 times
           BARE-FOOT |     1 times
           ASSOCIATE |     1 times
            VISITING |     1 times
             FINDING |     1 times
           SEARCHERS |     1 times
          SUSPECTING |     1 times
          INFECTIOUS |     1 times
          PESTILENCE |     1 times
               DOORS |     2 times
           IT,--HERE |     1 times
            AGAIN,-- |     1 times
         BROTHERHOOD |     1 times
          NEGLECTING |     1 times
              DANGER |     1 times
              NOTICE |     1 times
           ACCIDENTS |     1 times
          CHURCHYARD |     8 times
               ALOOF |     3 times
           YEW-TREES |     1 times
             HOLDING |     1 times
               TREAD |     1 times
               LOOSE |     1 times
              UNFIRM |     1 times
             DIGGING |     1 times
              GRAVES |     2 times
             WHISTLE |     1 times
              SIGNAL |     1 times
              AFRAID |     1 times
             RETIRES |     3 times
            STREW,-- |     1 times
              CANOPY |     1 times
                DUST |     1 times
           STONES;-- |     1 times
           DISTILL'D |     1 times
               MOANS |     1 times
           OBSEQUIES |     2 times
               STREW |     3 times
            WHISTLES |     1 times
             WARNING |     1 times
             WANDERS |     1 times
              MUFFLE |     1 times
             MATTOCK |     2 times
             MATTOCK |     1 times
           WRENCHING |     1 times
             DELIVER |     1 times
            WHATE'ER |     1 times
           INTERRUPT |     1 times
              PARTLY |     1 times
             CHIEFLY |     1 times
          EMPLOYMENT |     1 times
                 PRY |     1 times
              INTEND |     1 times
               JOINT |     1 times
               JOINT |     1 times
              HUNGRY |     1 times
             INTENTS |     4 times
         SAVAGE-WILD |     1 times
              FIERCE |     1 times
          INEXORABLE |     1 times
              TIGERS |     1 times
          FRIENDSHIP |     1 times
           HEREABOUT |     1 times
                 MAW |     1 times
              GORGED |     1 times
             DEAREST |     1 times
              MORSEL |     1 times
             ENFORCE |     1 times
              ROTTEN |     1 times
                JAWS |     1 times
             DESPITE |     1 times
                CRAM |     1 times
               OPENS |     1 times
             HAUGHTY |     1 times
            CREATURE |     1 times
                DIED |     1 times
           VILLANOUS |     1 times
              BODIES |     1 times
           APPREHEND |     3 times
          UNHALLOW'D |     1 times
           CONDEMNED |     2 times
               TEMPT |     1 times
            AFFRIGHT |     1 times
              URGING |     1 times
            MADMAN'S |     1 times
        CONJURATIONS |     1 times
               FELON |     1 times
             PROVOKE |     1 times
              PERUSE |     1 times
            BETOSSED |     1 times
                RODE |     1 times
        MISFORTUNE'S |     1 times
          TRIUMPHANT |     1 times
             LANTERN |     2 times
            INTERR'D |     1 times
             KEEPERS |     1 times
           CONQUER'D |     1 times
              ENSIGN |     1 times
             CRIMSON |     1 times
                FLAG |     1 times
               LIEST |     1 times
               SHEET |     1 times
              SUNDER |     1 times
       UNSUBSTANTIAL |     1 times
                LEAN |     1 times
            ABHORRED |     1 times
             MONSTER |     1 times
            PARAMOUR |     1 times
               WORMS |     1 times
       CHAMBER-MAIDS |     1 times
                YOKE |     1 times
        INAUSPICIOUS |     1 times
       WORLD-WEARIED |     1 times
             EMBRACE |     1 times
                SEAL |     2 times
           RIGHTEOUS |     1 times
            DATELESS |     1 times
             BARGAIN |     1 times
          ENGROSSING |     1 times
           UNSAVOURY |     1 times
               GUIDE |     1 times
             DASHING |     1 times
               ROCKS |     1 times
            SEA-SICK |     1 times
               WEARY |     1 times
               SPADE |     2 times
                FEET |     1 times
            STUMBLED |     1 times
              VAINLY |     1 times
               GRUBS |     1 times
             EYELESS |     1 times
             DISCERN |     1 times
             BURNETH |     1 times
           FEARFULLY |     1 times
              MENACE |     1 times
            YEW-TREE |     1 times
            ADVANCES |     1 times
              STAINS |     1 times
           SEPULCHRE |     2 times
          MASTERLESS |     1 times
                GORY |     1 times
         DISCOLOUR'D |     1 times
             STEEP'D |     1 times
              UNKIND |     1 times
               STIRS |     1 times
         COMFORTABLE |     1 times
           CONTAGION |     1 times
           UNNATURAL |     1 times
             GREATER |     1 times
          CONTRADICT |     1 times
            THWARTED |     1 times
             DISPOSE |     1 times
          SISTERHOOD |     1 times
                NUNS |     1 times
            TIMELESS |     1 times
               CHURL |     1 times
            FRIENDLY |     1 times
                DROP |     1 times
               HAPLY |     1 times
         RESTORATIVE |     1 times
            WATCHMAN |     8 times
           SNATCHING |     1 times
              SHEATH |     1 times
                RUST |     1 times
             WHOE'ER |     1 times
              ATTACH |     1 times
            BLEEDING |     1 times
             WHEREON |     1 times
              DESCRY |     1 times
              SAFETY |     1 times
            TREMBLES |     1 times
           SUSPICION |     2 times
              SHRIEK |     1 times
              PEOPLE |     1 times
              OUTCRY |     1 times
            STARTLES |     1 times
           SOVEREIGN |     1 times
               TOMBS |     1 times
              BLEEDS |     1 times
       MISTA'EN--FOR |     1 times
         MONTAGUE,-- |     1 times
        MIS-SHEATHED |     1 times
                BELL |     1 times
               WARNS |     1 times
               LIEGE |     1 times
               SON'S |     1 times
             STOPP'D |     1 times
           CONSPIRES |     1 times
            UNTAUGHT |     1 times
               CLEAR |     1 times
         AMBIGUITIES |     1 times
             DESCENT |     1 times
            MEANTIME |     2 times
           MISCHANCE |     1 times
             PARTIES |     1 times
            GREATEST |     1 times
               LEAST |     1 times
           SUSPECTED |     1 times
             DIREFUL |     1 times
             IMPEACH |     1 times
               PURGE |     1 times
             EXCUSED |     1 times
        MARRIAGE-DAY |     1 times
               PINED |     1 times
           BETROTH'D |     1 times
                 RID |     1 times
             TUTOR'D |     1 times
            SLEEPING |     1 times
              POTION |     1 times
            INTENDED |     1 times
                DIRE |     1 times
            POTION'S |     1 times
               FORCE |     1 times
            ACCIDENT |     1 times
         YESTERNIGHT |     1 times
            RETURN'D |     1 times
            PREFIXED |     1 times
             CLOSELY |     1 times
        CONVENIENTLY |     1 times
             AWAKING |     1 times
           ENTREATED |     1 times
               SCARE |     1 times
            VIOLENCE |     1 times
               PRIVY |     1 times
          MISCARRIED |     1 times
          SACRIFICED |     1 times
              RIGOUR |     1 times
            SEVEREST |     1 times
             BROUGHT |     1 times
          THREATENED |     1 times
            DEPARTED |     1 times
            COUNTY'S |     1 times
             FRIAR'S |     1 times
              WRITES |     1 times
          'POTHECARY |     1 times
         THEREWITHAL |     1 times
             SCOURGE |     1 times
             WINKING |     1 times
               BRACE |     1 times
            PUNISH'D |     1 times
            JOINTURE |     1 times
              DEMAND |     1 times
              STATUE |     1 times
              FIGURE |     1 times
          SACRIFICES |     1 times
            GLOOMING |     1 times
            PARDON'D |     1 times

Process returned 0 (0x0)   execution time : 3.766 s
Press any key to continue.

*/
